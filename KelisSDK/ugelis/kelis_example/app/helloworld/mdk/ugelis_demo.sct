; *************************************************************
; *** Scatter-Loading Description File generated by uVision ***
; *************************************************************

;physical address of RAM;
#! armclang -E#define START_ADDRESS 0x100000
#define PAGE_ALIGNMENT 0x100000

#include<linker/linker-defs.h>

LOAD_REGION  0x00010000  NOCOMPRESS
{	; load region size_region
	VECTOR_REGION 0x00010000 NOCOMPRESS
	{  ; load address = execution address
		*(.exc_vector_table._vector_table_section, +First)
		*(.exc_vector_table)
		*(.exc_vector_table.*)
		*(.irq_vector_table)
		*(.sw_isr_table)
	}
	TEXT_REGION +0 ALIGN 4 NOCOMPRESS
	{
		*(.text)
		*(.text.*)
		*(.gnu.linkonce.t.*)
		.ANY (+RO)
	}
	RODATA_REGION +0  ALIGN 4 NOCOMPRESS
	{  ; load address = execution address
		*(.rodata)
		*(.rodata.*)
		*(.gnu.linkonce.r.*)
	}	
  
	DATA_START_REGION  +0xC0000000  ALIGN 4 NOCOMPRESS
	{  ; load address = execution address
		*(.data)
		*(.data.*)
		*(.kernel.*)
	}
	DEVCONFIG_REGION +0  ALIGN 4 NOCOMPRESS
	{
		*(.devconfig.*)
		*(.devconfig*)
	}
	DEVICE_PRE_KERNEL1_REGION +0 ALIGN 4 NOCOMPRESS SORTTYPE Lexical
	{
		*(.init_PRE_KERNEL_1*)
	}
	DEVICE_PRE_KERNEL2_REGION +0 ALIGN 4 NOCOMPRESS
	{
		*(.init_PRE_KERNEL_2*)
	}
	DEVICE_POST_KERNEL_REGION +0 ALIGN 4  NOCOMPRESS
	{
		*(.init_POST_KERNEL*)
	}
	DEVICE_APPLICATION_REGION +0 ALIGN 4  NOCOMPRESS
	{
		*(.init_APPLICATION*)
	}
	KMEM_SLAB_REGION +0  ALIGN 4  NOCOMPRESS
	{
		*(._k_mem_slab.static.*)
	}
	KMEM_POOL_REGION +0  ALIGN 4  NOCOMPRESS
	{
		*(._k_mem_pool.static.*)
	}
	KTIMER_REGION +0  ALIGN 4  NOCOMPRESS
	{
		*(._k_timer.static.*)
	}
	KSEM_REGION +0  ALIGN 4  NOCOMPRESS
	{
		*(._k_sem.static.*)
	}
	KMUTEX_REGION +0  ALIGN 4  NOCOMPRESS
	{
		*(._k_mutex.static.*)
	}
	KALERT_REGION +0  ALIGN 4  NOCOMPRESS
	{
		*(._k_alert.static.*)
	}
	KQUEUE_REGION +0  ALIGN 4  NOCOMPRESS
	{
		*(._k_queue.static.*)
	}
	KSTACK_REGION +0  ALIGN 4  NOCOMPRESS
	{
		*(._k_stack.static.*)
	}
	KMSGQ_REGION +0  ALIGN 4  NOCOMPRESS
	{
		*(._k_msgq.static.*)
	}
	KMBOX_REGION +0  ALIGN 4  NOCOMPRESS
	{
		*(._k_mbox.static.*)
	}
	STATIC_THREAD_REGION +0  ALIGN 4  NOCOMPRESS
	{
		*(._static_thread_data.static.*)
	}
	DATA_END_REGION +0 ALIGN 4  NOCOMPRESS
	{  ; RW data
		.ANY (+RW +ZI)
	}
	BSS_REGION +0  ALIGN 4  NOCOMPRESS
	{  ; load address = execution address
		*(.bss)
		*(.bss.*)
		*(.kernel_bss.*)
	}
	NOINIT_REGION +0 ALIGN 4  NOCOMPRESS
	{
		*(.noinit)
		*(.noinit.*)
		*(.kernel_noinit.*)
	}
	VT_REGION +0  ALIGN 4  NOCOMPRESS
	{  ; load address = execution address
		*(.vt_pointer_section)
		*(.vt_pointer_section.*)
	}
}