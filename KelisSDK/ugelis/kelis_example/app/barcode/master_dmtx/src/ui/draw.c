#include <string.h>

#include "draw.h"
#include "font.h"
#define PIC_WIDTH  LCD_UI_W
#define PIC_HEIGHT LCD_UI_H

extern uint32_t ui_buf_addr;
//ARGB8888

static void lcd_draw_point(uint16_t dx, uint16_t dy, uint32_t color);

#define LOGO_W 32
#define LOGO_H 32
#define LOGOSIZE (LOGO_W*LOGO_H*4)
const unsigned char logo[LOGOSIZE] =   /* 0X00,0X20,0X10,0X00,0X10,0X00,0X00,0X1B, */
{
    0X00, 0X00, 0X00, 0X00, 0X00, 0X00, 0X00, 0X00, 0X00, 0X00, 0X00, 0X00, 0X00, 0X00, 0X00, 0X00,
    0X00, 0X00, 0X00, 0X00, 0X00, 0X00, 0X00, 0X00, 0X00, 0X00, 0X00, 0X00, 0X00, 0X00, 0X00, 0X00,
    0X00, 0X00, 0X00, 0X00, 0X00, 0X00, 0X00, 0X00, 0X00, 0X00, 0X00, 0X00, 0XA7, 0X6E, 0X1C, 0X00,
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    0X00, 0X00, 0X00, 0X00, 0X00, 0X00, 0X00, 0X00, 0X00, 0X00, 0X00, 0X00, 0X00, 0X00, 0X00, 0X00,

};

//@Todo: Alpha blending problems
void lcd_drawlogo(int x, int y, unsigned int color)
{
    int j = 0;
    int i = 0;
    int index = 0;
    int w = 32;
    int h = 32;
    unsigned int *addr = (unsigned int *)logo;
    for (i = 0; i < h; i++)
    {
        for (j = 0; j < w; j++)
        {
            lcd_draw_point(x + i, y + j, addr[index]);
            index += 1;
        }
    }
}

void lcd_clear_area(int x, int y, int w, int h)
{
    int j = 0;
    unsigned char *start_addr;
    for (j = 0; j < h; j++)
    {
        start_addr = ((unsigned char *)ui_buf_addr) + (PIC_WIDTH * (y + j) + x) * 4;
        memset(start_addr, 0, w * 4);
    }
}

static void lcd_draw_point(uint16_t dx, uint16_t dy, uint32_t color)
{
    *(uint32_t *)((uint32_t)ui_buf_addr + ((PIC_WIDTH * dy + dx) << 2)) = color;
}

static void lcd_draw_line(uint16_t x1, uint16_t y1, uint16_t x2, uint16_t y2, uint32_t color)
{
    uint16_t t;
    int xerr = 0, yerr = 0, delta_x, delta_y, distance;
    int incx, incy, uRow, uCol;
    delta_x = x2 - x1; //计算坐标增量
    delta_y = y2 - y1;
    uRow = x1;
    uCol = y1;
    if (delta_x > 0)
    {
        incx = 1;    //设置单步方向
    }
    else if (delta_x == 0)
    {
        incx = 0;    //垂直线
    }
    else
    {
        incx = -1;
        delta_x = -delta_x;
    }
    if (delta_y > 0)
    {
        incy = 1;
    }
    else if (delta_y == 0)
    {
        incy = 0;    //水平线
    }
    else
    {
        incy = -1;
        delta_y = -delta_y;
    }
    if (delta_x > delta_y)
    {
        distance = delta_x;    //选取基本增量坐标轴
    }
    else
    {
        distance = delta_y;
    }
    for (t = 0; t <= distance + 1; t++) //画线输出
    {
        lcd_draw_point(uRow, uCol, color); //画点
        xerr += delta_x ;
        yerr += delta_y ;
        if (xerr > distance)
        {
            xerr -= distance;
            uRow += incx;
        }
        if (yerr > distance)
        {
            yerr -= distance;
            uCol += incy;
        }
    }
}


void lcd_draw_rectangle(uint16_t x1, uint16_t y1, uint16_t x2, uint16_t y2, uint32_t color)
{
    lcd_draw_line(x1, y1, x2, y1, color);
    lcd_draw_line(x1, y1, x1, y2, color);
    lcd_draw_line(x1, y2, x2, y2, color);
    lcd_draw_line(x2, y1, x2, y2, color);
}

//bbggrr24(h-l) ==> argb32
void lcd_draw_rgb24(unsigned char *src, int x, int y, int w, int h)
{
    int i, j, cnt = 0;
    unsigned int color = 0xff000000;
    unsigned char *b = src;
    unsigned char *g = src + w * h;
    unsigned char *r = src + w * h * 2;

    for (j = 0; j < h; j++)
    {
        for (i = 0; i < w; i++)
        {
            color = 0xff000000;
            color |= *(r + cnt);//r
            color |= *(g + cnt) << 8; //g
            color |= *(b + cnt) << 16; //b
            lcd_draw_point(x + i, y + j, color);
            cnt++;
        }
    }
}

static void lcd_showchar(uint16_t x, uint16_t y, uint8_t num, uint8_t size, uint8_t mode, uint32_t color)
{
    uint8_t temp, t1, t;
    uint16_t y0 = y;
    uint8_t csize = (size / 8 + ((size % 8) ? 1 : 0)) * (size / 2);
    num = num - ' ';
    for (t = 0; t < csize; t++)
    {
        if (size == 12)
        {
            temp = asc2_1206[num][t];
        }
        else if (size == 16)
        {
            temp = asc2_1608[num][t];
        }
        else if (size == 24)
        {
            temp = asc2_2412[num][t];
        }
        else if (size == 32)
        {
            temp = asc2_3216[num][t];
        }
        else
        {
            return;
        }
        for (t1 = 0; t1 < 8; t1++)
        {
            if (temp & 0x80)
            {
                lcd_draw_point(x, y, color);
            }
            else if (mode == 0)
            {
                lcd_draw_point(x, y, BACK_COLOR);
            }
            temp <<= 1;
            y++;
            if (y >= PIC_HEIGHT)
            {
                return;
            }
            if ((y - y0) == size)
            {
                y = y0;
                x++;
                if (x >= PIC_WIDTH)
                {
                    return;
                }
                break;
            }
        }
    }
}

void lcd_draw_text(uint16_t x, uint16_t y, uint16_t width, uint16_t height, uint8_t size, uint8_t *p, uint32_t color)
{
    uint8_t x0 = x;
    width += x;
    height += y;
    while ((*p <= '~') && (*p >= ' '))
    {
        if (x >= width)
        {
            x = x0;
            y += size;
        }
        if (y >= height)
        {
            break;
        }
        lcd_showchar(x, y, *p, size, 0, color);
        x += size / 2;
        p++;
    }
}

void lcd_clear(void)
{
    memset((unsigned char *)ui_buf_addr, 0, PIC_WIDTH * PIC_HEIGHT * 4);
    lcd_draw_rectangle(0, 0, PIC_WIDTH - 1, PIC_HEIGHT - 1, 0xFFFFFFFF);
    lcd_drawlogo(PIC_WIDTH - LOGO_W - 1, 1, 0xFFFF0000); //
    //lcd_drawlogo(1, 33, 0x0000ff00);
    //lcd_drawlogo(1, 65, 0xFF00ff00);
}
