## ulibs/midware/easynet_cross/Kconfig
```kconfig
# Kconfig - the obj_info project

#
# Copyright (c) 2015 Intel Corporation
#
# SPDX-License-Identifier: Apache-2.0
#

config EASYNET_CROSS
	bool
	prompt "EASYNET_CROSS Support"
	default n
	help
	This option enables the EASYNET_CROSS library.
```

## ulibs/midware/usb/device/class/Kconfig
```kconfig
# Kconfig - USB device stack configuration options
#
# Copyright (c) 2016 Wind River Systems, Inc.
#
# SPDX-License-Identifier: Apache-2.0
#
menu "USB Device Class"
	depends on GM_USB_DEVICE_STACK

config USB_MASS_STORAGE
	bool "USB Device Mass Storage Class"
	default n
	help
		This option sets usb class as Mass Storage Class

config USB_HID_MOUSE
	bool "USB HID Mouse Class"
	default n
	help
	This option sets usb class as HID Mouse Class

config USB_HID_CUSTOM
	bool "USB HID Custom Class"
	default n
	help
		This option sets usb class as HID Custom Class

config USB_AUDIO
	bool "USB Audio Class"
	default n
	help
		This option sets usb class as Audio Class

config USB_VIDEO
	bool "USB Video Class"
	default n
	help
		This option sets usb class as Video Class	

endmenu
```

## ulibs/midware/usb/host/class/Kconfig
```kconfig
# Kconfig - USB device stack configuration options

#
# Copyright (c) 2016 Wind River Systems, Inc.
#
# SPDX-License-Identifier: Apache-2.0
#
menu "USB Host Class"
    depends on GM_USB_HOST_STACK

config USB_MASS_STORAGE
    bool "USB Device Mass Storage Class"
    default n
    help
    This option sets usb class as Mass Storage Class

config USB_HID_MOUSE
	bool "USB Hid Mouse Class Driver"
	default n
	help
	USB Hid Mouse or KeyBoard class driver
	
config USB_AUDIO
	bool "USB Audio Speaker Driver"
	default n
	help
	USB Audio Speaker class driver
endmenu
```
