## ugelis/ext/lib/jerry-libm/Kconfig
```kconfig
# Kconfig - the JerryLibm project

#
# Copyright (c) 2015 Intel Corporation
#
# SPDX-License-Identifier: Apache-2.0
#

config JERRY_LIBM
	bool
	prompt "JERRY_LIBM Support"
	default n
	help
	This option enables the JERRY_LIBM library.
```

## ugelis/ext/lib/obj_info/Kconfig
```kconfig
# Kconfig - the obj_info project

#
# Copyright (c) 2015 Intel Corporation
#
# SPDX-License-Identifier: Apache-2.0
#

config OBJ_INFO
	bool
	prompt "OBJ_INFO Support"
	default n
	help
	This option enables the OBJ_INFO library.
```

## ugelis/ext/lib/openmv/Kconfig
```kconfig
# Kconfig - the OpenMV project

#
# Copyright (c) 2015 Intel Corporation
#
# SPDX-License-Identifier: Apache-2.0
#

config OPENMV
	bool
	prompt "OpenMV Support"
	default n
	help
	This option enables the OpenMV library.
```

## ugelis/kelis_example/driver_example/es_test/wwdg/sample.yaml
```yaml
sample:
  name: GM6721 iwdg sample application
tests:
  test:
    platform_whitelist: gm6721_evb
    tags: samples
    depends_on: watchdog
```

## ugelis/subsys/rpc/Kconfig
```kconfig
# Kconfig - ust configuration options

#
# Copyright (c) 2014-2015 Wind River Systems, Inc.
# Copyright (c) 2016 Intel Corporation
#
# SPDX-License-Identifier: Apache-2.0
#


config RPC_SUBSYS
	bool
	prompt "rpc subsys module"
	default n
	depends on GM_HAL_RPC
	help
	  Enable rpc subsys module.
```

## ugelis/subsys/usb_gm/Kconfig
```kconfig
# Kconfig - USB device stack configuration options
#
# Copyright (c) 2016 Wind River Systems, Inc.
#
# SPDX-License-Identifier: Apache-2.0
#

menu "USB Stack"

config GM_USB_DEVICE_STACK
	bool "Gree Microcontroller USB Device Stack"
	default n
	help
		This option enables USB Device Stack Option.

config GM_USB_HOST_STACK
	bool "Gree Microcontroller HOST Device Stack"
	default n
	help
		This option enables USB Host Stack Option.	

config USB_PINMUX
	bool "Gree Microcontroller USB Pinmux"
	default n
	help
		This option enables USB  pinmux.
source "subsys/usb_gm/device/class/Kconfig"
source "subsys/usb_gm/host/class/Kconfig"

endmenu
```

## ugelis/subsys/ust/Kconfig
```kconfig
# Kconfig - ust configuration options

#
# Copyright (c) 2014-2015 Wind River Systems, Inc.
# Copyright (c) 2016 Intel Corporation
#
# SPDX-License-Identifier: Apache-2.0
#


menuconfig UST
	bool
	prompt "tiny stream framework"
	help
	  Enable otiny stream framework.


if UST
config UST_CORE
	bool "tiny stream core"
	default y
	help
	  This is an option to be enabled the core of tiny stream framework.

source "subsys/ust/plugin/Kconfig"

endif
```

## ugelis/subsys/ust/plugin/Kconfig
```kconfig
# Kconfig - serial driver configuration options

#
# Copyright (c) 2014-2015 Wind River Systems, Inc.
#
# SPDX-License-Identifier: Apache-2.0
#

menuconfig UST_PLUGIN
	bool
	prompt "tiny streamer plugin"
	help
	  Enable options for tiny streamer plugin.

if UST_PLUGIN

source "subsys/ust/plugin/test_element/Kconfig"

source "subsys/ust/plugin/camera/Kconfig"
source "subsys/ust/plugin/filter/Kconfig"
source "subsys/ust/plugin/edge/Kconfig"
source "subsys/ust/plugin/lcd/Kconfig"

endif
```

## ugelis/subsys/ust/plugin/camera/Kconfig
```kconfig
# Kconfig - ust test plugin element configuration options

#
# Copyright (c) 2014-2015 Wind River Systems, Inc.
#
# SPDX-License-Identifier: Apache-2.0
#

config UST_PLUGIN_CAMERA
	bool
    default n
	prompt "UST Plugin Camera"
	help
	  This is an option to be enabled ust camera plugin

config UST_PLUGIN_CAMERA_QUEUE
	bool
    default n
    depends on UST_PLUGIN_CAMERA
	prompt "Enable Camera Queue"
	help
	  This is an option to be enabled camera queue

config UST_PLUGIN_CAMERA_QUEUE_MAX_NUM
	int
    default 3
    depends on UST_PLUGIN_CAMERA_QUEUE
	prompt "Config Queue Buf Num"
	help
	  This is an option to config buf num
```

## ugelis/subsys/ust/plugin/edge/Kconfig
```kconfig
# Kconfig - ust test plugin element configuration options

#
# Copyright (c) 2014-2015 Wind River Systems, Inc.
#
# SPDX-License-Identifier: Apache-2.0
#

config UST_PLUGIN_EDGE
	bool
    default n
	prompt "UST Edge Plugin"
	help
	  This is an option to be enabled ust edge plugin

config UST_PLUGIN_EDGE_QUEUE
	bool
    default n
    depends on UST_PLUGIN_EDGE
	prompt "Enable Edge Queue"
	help
	  This is an option to be enabled edge queue

config UST_PLUGIN_EDGE_QUEUE_MAX_NUM
	int
    default 3
    depends on UST_PLUGIN_EDGE_QUEUE
	prompt "Config Queue Buf Num"
	help
	  This is an option to config buf num
```

## ugelis/subsys/ust/plugin/filter/Kconfig
```kconfig
# Kconfig - ust test plugin element configuration options

#
# Copyright (c) 2014-2015 Wind River Systems, Inc.
#
# SPDX-License-Identifier: Apache-2.0
#

config UST_PLUGIN_FILTER
	bool
    default n
	prompt "UST Filter Plugin"
	help
	  This is an option to be enabled ust filter plugin

config UST_PLUGIN_FILTER_QUEUE
	bool
    default n
    depends on UST_PLUGIN_FILTER
	prompt "Enable Filter Queue"
	help
	  This is an option to be enabled filter queue

config UST_PLUGIN_FILTER_QUEUE_MAX_NUM
	int
    default 3
    depends on UST_PLUGIN_FILTER_QUEUE
	prompt "Config Queue Buf Num"
	help
	  This is an option to config buf num
```

## ugelis/subsys/ust/plugin/lcd/Kconfig
```kconfig
# Kconfig - ust test plugin element configuration options

#
# Copyright (c) 2014-2015 Wind River Systems, Inc.
#
# SPDX-License-Identifier: Apache-2.0
#

config UST_PLUGIN_LCD
	bool
    default n
	prompt "UST LCD Plugin"
	help
	  This is an option to be enabled ust lcd plugin
```

## ugelis/subsys/ust/plugin/test_element/Kconfig
```kconfig
# Kconfig - ust test plugin element configuration options

#
# Copyright (c) 2014-2015 Wind River Systems, Inc.
#
# SPDX-License-Identifier: Apache-2.0
#


menuconfig UST_TEST_ELEMENT
	bool
	prompt "tiny streamer test element plugin"
	help
	  Enable options for tiny streamer test element plugin.

if UST_TEST_ELEMENT
config SRC_ELEMENT
	bool
    default n
	prompt "Enable Src Element For Plugin Test"
	help
	  This is an option to be enabled src element for plugin test


config SINK_ELEMENT
	bool
    default n
	prompt "Enable Sink Element For Plugin Test"
	help
	  This is an option to be enabled sink element for plugin test

config SRC_ELEMENT_QUEUE
	bool
    default n
    depends on SINK_ELEMENT
	prompt "Enable Sink Element Queue"
	help
	  This is an option to be enabled src element queue for plugin test

config SRC_ELEMENT_QUEUE_BUFMAX_NUM
	int
    default 3
    depends on SRC_ELEMENT_QUEUE
	prompt "Config Src Element Queue Buf Num"
	help
	  This is an option to config src element queue buf num






config MID_ELEMENT
	bool
    default n
	prompt "Enable Middle Element For Plugin Test"
	help
	  This is an option to be enabled middle element for plugin test

endif
```

## ulibs/hal/gree/Kconfig.gm6721x
```kconfig
# Kconfig - GM721x HAL Drv Configuration



menuconfig GM_HAL_CPU
	bool
	prompt "support hal misc cpu feature driver" if (GM_HAL_BUILTIN && SOC_SERIES_GM6721X)
	default n
	help
	  Include support for GM_HAL_CPU.

if GM_HAL_CPU
config GM_HAL_CACHE
       bool "support hal cpu cache driver"
       default n
       depends on GM_HAL_BUILTIN && SOC_SERIES_GM6721X
       help
       support hal cpu cache driver

config GM_ARM_HAL_MPU
       bool "support hal mpu driver"
       default n
       depends on GM_HAL_BUILTIN && SOC_SERIES_GM6721X
       help
       support hal mpu driver

config GM_ARM_HAL_FLASH_PATCH
       bool "support hal flash patch driver"
       default n
       depends on GM_HAL_BUILTIN && SOC_SERIES_GM6721X
       help
       support hal flash patch driver


config GM_ARM_HAL_BUS_MAPPING
       bool "support hal bus maping driver"
       default n
       depends on GM_HAL_BUILTIN && SOC_SERIES_GM6721X
       help
       support hal bus maping driver
endif


menuconfig GM_HAL_RPC

	bool
	prompt "support hal rpc driver" if (GM_HAL_BUILTIN && SOC_SERIES_GM6721X)
	default n
	help
	  support hal cpu rpc driver

if GM_HAL_RPC
config GM_HAL_RPC_MASTER
       bool "support hal rpc master"
       default n
       help
       support hal rpc master

config GM_HAL_RPC_SLAVE
       bool "support hal rpc slave"
       default n
       help
       support hal rpc slave

endif


config GM_HAL_WWDG
       bool "support hal wwdg driver"
       default n
       depends on GM_HAL_BUILTIN && SOC_SERIES_GM6721X
       help
       support hal wwdg driver

config GM_HAL_LVD
       bool "support hal lvd driver"
       default n
       depends on GM_HAL_BUILTIN && SOC_SERIES_GM6721X
       help
       support hal lvd driver


config GM_HAL_RTC
       bool "support hal rtc driver"
       default n
       depends on GM_HAL_BUILTIN && SOC_SERIES_GM6721X
       help
       support hal rtc driver
if GM_HAL_RTC
config GM_HAL_RTC_DISABLE_INNER_ISR
       bool "disable rtc inner isr"
       default n
       depends on GM_HAL_RTC
       help
       disable rtc inner isr
endif


config GM_HAL_FLASH
       bool "support hal flash driver"
       default n
       depends on GM_HAL_BUILTIN && SOC_SERIES_GM6721X
       help
       support hal flash driver



config GM_HAL_DMA
       bool "support hal dma driver"
       default n
       depends on GM_HAL_BUILTIN && SOC_SERIES_GM6721X
       help
       support hal dma driver

config GM_HAL_GPIO
       bool "support hal gpio driver"
       default n
       depends on GM_HAL_BUILTIN && SOC_SERIES_GM6721X
       help
       support hal gpio driver

config GM_HAL_ADC
       bool "support hal adc driver"
       default n
       depends on GM_HAL_BUILTIN && SOC_SERIES_GM6721X
       help
       support hal adc driver

config GM_HAL_TIM
       bool "support hal tim driver"
       default n
       depends on GM_HAL_BUILTIN && SOC_SERIES_GM6721X
       help
       support hal tim driver

config GM_HAL_LPETM
       bool "support hal lpetm adc driver"
       default n
       depends on GM_HAL_BUILTIN && SOC_SERIES_GM6721X
       help
       support hal lpetm driver

config GM_HAL_OTP
       bool "support hal otp driver"
       default n
       depends on GM_HAL_BUILTIN && SOC_SERIES_GM6721X
       help
       support hal otp driver

config GM_HAL_PES
       bool "support hal pes system driver"
       default n
       depends on GM_HAL_BUILTIN && SOC_SERIES_GM6721X
       help
       support hal pes system driver

config GM_HAL_I2C
       bool "support hal i2c driver"
       default n
       depends on GM_HAL_BUILTIN && SOC_SERIES_GM6721X
       help
       support hal i2c driver

config GM_HAL_UART
       bool "support hal uart driver"
       default y
       depends on GM_HAL_BUILTIN && SOC_SERIES_GM6721X
       help
       support hal uart driver

config GM_HAL_SPI
       bool "support hal spi driver"
       default n
       depends on GM_HAL_BUILTIN && SOC_SERIES_GM6721X
       help
       support hal spi driver

config GM_HAL_CRC
       bool "support hal crc driver"
       default n
       depends on GM_HAL_BUILTIN && SOC_SERIES_GM6721X
       help
       support hal crc driver

config GM_HAL_USB
       bool "support hal usb driver"
       default n
       depends on GM_HAL_BUILTIN && SOC_SERIES_GM6721X
       help
       support hal usb driver

config GM_HAL_BASETIME
       bool "support hal basetime driver"
       default n
       depends on GM_HAL_BUILTIN && SOC_SERIES_GM6721X
       help
       support hal basetime driver

config GM_HAL_KBI
       bool "support hal kbi driver"
       default n
       depends on GM_HAL_BUILTIN && SOC_SERIES_GM6721X
       help
       support hal kbi driver


config GM_HAL_SPIFLASH
       bool "support hal spiflash driver"
       default n
       depends on GM_HAL_BUILTIN && SOC_SERIES_GM6721X
       help
       support hal spiflash driver


config GM_HAL_KDP
       bool "support hal kdp driver"
       default n
       depends on GM_HAL_BUILTIN && SOC_SERIES_GM6721X
       help
       support hal kdp driver

config GM_HAL_SAI
       bool "support hal sai driver"
       default n
       depends on GM_HAL_BUILTIN && SOC_SERIES_GM6721X
       help
       support hal sai driver
config GM_HAL_PDM
       bool "support hal pdm driver"
       default n
       depends on GM_HAL_BUILTIN && SOC_SERIES_GM6721X
       help
       support hal pdm driver

config GM_HAL_IWDG
       bool "support hal iwdg driver"
       default n
       depends on GM_HAL_BUILTIN && SOC_SERIES_GM6721X
       help
       support hal iwdg driver

config GM_HAL_TRNG
       bool "support hal trng driver"
       default n
       depends on GM_HAL_BUILTIN && SOC_SERIES_GM6721X
       help
       support hal trng driver

config GM_HAL_IMP
       bool "support hal imp driver"
       default n
       depends on GM_HAL_BUILTIN && SOC_SERIES_GM6721X
       help
       support hal imp driver

config GM_HAL_VIN
       bool "support hal vin driver"
       default n
       depends on GM_HAL_BUILTIN && SOC_SERIES_GM6721X
       help
       support hal vin driver

config GM_HAL_VOUT
       bool "support hal vout driver"
       default n
       depends on GM_HAL_BUILTIN && SOC_SERIES_GM6721X
       help
       support hal vout driver

config GM_HAL_CAN
       bool "support hal can driver"
       default n
       depends on GM_HAL_BUILTIN && SOC_SERIES_GM6721X
       help
       support hal can driver

config GM_HAL_FMC
       bool "support hal fmc driver"
       default n
       depends on GM_HAL_BUILTIN && SOC_SERIES_GM6721X
       help
       support hal fmc driver

config GM_HAL_TRNG
       bool "support hal TRNG  driver"
       default n
       depends on GM_HAL_BUILTIN && SOC_SERIES_GM6721X
       help
         If select, it will compile the hal TRNG  driver.

config GM_HAL_CRYPTO
       bool "support hal Crypto  driver"
       default n
       depends on GM_HAL_BUILTIN && SOC_SERIES_GM6721X
       help
         If select, it will compile the hal Crypto Engine driver.

config GM_HAL_HASH
       bool "support hal Hash  driver"
       default n
       depends on GM_HAL_BUILTIN && SOC_SERIES_GM6721X
       help
         If select, it will compile the  hash driver.


config GM_HAL_SQI
       bool "support hal sqi driver"
       default n
       depends on GM_HAL_BUILTIN && SOC_SERIES_GM6721X
       help
       support hal sqi driver

config GM_HAL_NF
       bool "support hal nandflash driver"
       default n
       depends on GM_HAL_BUILTIN && SOC_SERIES_GM6721X
       help
       support hal nf driver

config GM_HAL_MMC
       bool "support hal mmc driver"
       default n
       depends on GM_HAL_BUILTIN && SOC_SERIES_GM6721X
       help
         If select, it will compile the mmc driver.

config GM_HAL_RTC
       bool "support hal rtc driver"
       default n
       depends on GM_HAL_BUILTIN && SOC_SERIES_GM6721X
       help
         If select, it will compile the rtc driver.

config GM_HAL_SDRAM
       bool "support hal sdram driver"
       default n
       depends on GM_HAL_BUILTIN && SOC_SERIES_GM6721X
       help
         If select, it will compile the sdram driver.
config GM_HAL_ACMP
       bool "support hal acmp driver"
       default n
       depends on GM_HAL_BUILTIN && SOC_SERIES_GM6721X
       help
       support hal acmp driver
config GM_HAL_CLOCK
	   bool "support hal clock driver"
	   default y
	   depends on GM_HAL_BUILTIN && SOC_SERIES_GM6721X
	   help
	     If select, it will compile the clock driver

config GM_HAL_DAC
       bool "support hal dac driver"
       default n
       depends on GM_HAL_BUILTIN && SOC_SERIES_GM6721X
       help
       support hal dac driver

config GM_HAL_RESET
       bool "support hal reset driver"
       default y
       depends on GM_HAL_BUILTIN && SOC_SERIES_GM6721X
       help
       support hal reset driver

config GM_HAL_POWER
       bool "support hal power driver"
       default n
       select GM_HAL_RTC



       depends on GM_HAL_BUILTIN && SOC_SERIES_GM6721X
       help
       support hal power driver
```
