## ugelis/dts/bindings/media/gree,gm-vout.yaml
```yaml
---
title: GM6721X VOUT
id: gree,gm-vout
version: 0.1

description: >
    This binding gives a base representation of the GM6721X VOUT

properties:
    compatible:
      type: string
      category: required
      description: compatible strings
      constraint: "gree,gm-vout"

    reg:
      type: array
      description: mmio register space
      generation: define
      category: required

    interrupts:
      type: array
      category: required
      description: required interrupts
      generation: define

    label:
      type: string
      category: required
      description: Human readable string describing the device (used by Ugelis for API name)
      generation: define
      
    vbp:
      type: int
      category: required
      description: vertical back porch
      generation: define

    vfp:
      type: int
      category: required
      description: vertical front porch
      generation: define

    hbp:
      type: int
      category: required
      description: horizontal back porch
      generation: define
      
    hfp:
      type: int
      category: required
      description: horizontal front porch
      generation: define

    vsw:
      type: int
      category: required
      description: vertical sync width
      generation: define

    hsw:
      type: int
      category: required
      description: horizontal sync width
      generation: define

    pllsain:
      type: int
      category: required
      description: the multiplication factor for PLLI2S VCO output clock
      generation: define

    pllsaiq:
      type: int
      category: required
      description: the division factor for LTDC clock
      generation: define

    pllsaidivr:
      type: int
      category: required
      description: the division factor for LTDC clock
      generation: define
      
    width:
      type: int
      category: required
      description: picture width
      generation: define

    height:
      type: int
      category: required
      description: picture height
      generation: define
...
```

## ugelis/dts/bindings/mmc/gree,gm-mmc.yaml
```yaml
---
title: GREE MMC
id: gree,gm-mmc
version: 0.1

description: >
    This binding gives a base representation of the GREE MMC

inherits:
    !include mmc.yaml

properties:
    compatible:
      type: string
      category: required
      description: compatible strings
      constraint: "gree,gm-mmc"

    reg:
      type: array
      description: mmio register space
      generation: define
      category: required

    interrupts:
      type: array
      category: required
      description: required interrupts
      generation: define

    busWitch:
      type: int
      category: required
      description: mmc work line mode
      generation: define

    type:
      type: int
      category: required
      description: the perpheral connnet to mmc port
      generation: define

    removable:
      type: int
      category: required
      description: the perpheral connnet to mmc port whether to remove
      generation: define

    poll_detect_card_hotplug:
      type: string
      category: required
      description: detect card hotplug mode
      generation: define
...
```

## ugelis/dts/bindings/pdm/gree,gm-pdm.yaml
```yaml
---
title: GREE PDM
id: gree,gm-pdm
version: 0.1

description: >
    This binding gives a base representation of the GREE PDM

inherits:
    !include pdm.yaml

properties:
    compatible:
      type: string
      category: required
      description: compatible strings
      constraint: "gree,gm-pdm"

    reg:
      type: array
      description: mmio register space
      generation: define
      category: required

    interrupts:
      type: array
      category: required
      description: required interrupts
      generation: define

    type:
      type: int
      category: required
      description: the perpheral connnet to pdm port
      generation: define

...
```

## ugelis/dts/bindings/pdm/pdm.yaml
```yaml
---
title: Pdm Base Structure
id: pdm
version: 0.1

description: >
    This binding gives the base structures for all PDM devices

properties:
    label:
      type: string
      category: required
      description: Human readable string describing the device (used by uGelis for API name)
      generation: define
    interrupt-names:
      type: stringlist
      category: optional
      description: names of required interrupts
      generation: define
    pinctrl-\d+:
      type: array
      category: optional
      description: pinmux information for RX, TX, CTS, RTS
      generation: define
...
```

## ugelis/dts/bindings/power/gree,gm-power.yaml
```yaml
---
title: GREE POWER
id: gree,gm-power
version: 0.1

description: >
    This binding gives a base representation of the GREE POWER

inherits:
    !include power.yaml

properties:
    compatible:
      type: string
      category: required
      description: compatible strings
      constraint: "gree,gm-power"

    reg:
      type: array
      description: mmio register space
      generation: define
      category: required

    interrupts:
      type: array
      category: required
      description: required interrupts
      generation: define

    wkpin_xpa0_status:
      type: int
      category: required
      description: wkpin_xpa0_enable or disable
      generation: define

    wkpin_xpa0_valid_edge:
      type: int
      category: required
      description: xpa0 wakeup system level edge
      generation: define

    wkpin_xpb12_status:
      type: int
      category: required
      description: wkpin_xpb12_enable or disable
      generation: define

    wkpin_xpb12_valid_edge:
      type: int
      category: required
      description: xpb12 wakeup system level edge
      generation: define
 
    wkpin_xpb13_status:
      type: int
      category: required
      description: wkpin_xpb13_enable or disable
      generation: define

    wkpin_xpb13_valid_edge:
      type: int
      category: required
      description: xpb13 wakeup system level edge
      generation: define
      
    pm_shutdown_status_pin_inv:
      type: int
      category: required
      description: pm_shutdown_status_pin_inv
      generation: define
      
    pm_hash_status:
      type: int
      category: required
      description: pm_hash enable or disable
      generation: define

...
```

## ugelis/dts/bindings/rtc/gree,gm-rtc.yaml
```yaml
#
# Copyright (c) 2018, GREE
#
# SPDX-License-Identifier: Apache-2.0
#
---
title: GREE RTC
id: gree,gm-rtc
version: 0.1

description: >
    This binding gives a base representation of the GREE RTC


properties:
    compatible:
      type: string
      category: required
      description: compatible strings
      constraint: "gree,gm-rtc"

    reg:
      type: array
      description: mmio register space
      generation: define
      category: required

    label:
      type: string
      category: required
      generation: define
      description: string describing the device (used by Ugelis for API name)

    interrupts:
      type: array
      category: required
      description: required interrupts
      generation: define

    clocks:
      type: array
      category: required
      description: Clock gate control information
      generation: structures

    clk_src:
      type: int
      category: required
      description: RTC clock source
      generation: define

...
```

## ugelis/dts/bindings/sai/gree,gm-sai.yaml
```yaml
---
title: GREE SAI
id: gree,gm-sai
version: 0.1

description: >
    This binding gives a base representation of the GREE SAI

inherits:
    !include sai.yaml

properties:
    compatible:
      type: string
      category: required
      description: compatible strings
      constraint: "gree,gm-sai"

    reg:
      type: array
      description: mmio register space
      generation: define
      category: required

    interrupts:
      type: array
      category: required
      description: required interrupts
      generation: define

    type:
      type: int
      category: required
      description: the perpheral connnet to sai port
      generation: define

...
```

## ugelis/dts/bindings/serial/gree,gm-uart.yaml
```yaml
---
title: GREE UART
id: gree,gm-uart
version: 0.1

description: >
    This binding gives a base representation of the GREE UART

inherits:
    !include uart.yaml

properties:
    compatible:
      type: string
      category: required
      description: compatible strings
      constraint: "gree,gm-uart"

    reg:
      type: array
      description: mmio register space
      generation: define
      category: required

    interrupts:
      type: array
      category: required
      description: required interrupts
      generation: define

    parity:
      type: int
      category: required
      description: uart stop bit count
      generation: define

    wordLength:
      type: int
      category: required
      description: uart data bit count
      generation: define

    stopBits:
      type: int
      category: required
      description: uart stop bit count
      generation: define

    clockSrc:
      type: int
      category: required
      description: uart clock source
      generation: define

    clocks:
      type: array
      category: required
      description: Clock gate control information
      generation: define
...
```

## ugelis/dts/bindings/tim/gm,gree-tim.yaml
```yaml
---
title: GREE TIM
id: gree,gm-tim
version: 0.1

description: >
    This binding gives a base representation of the GREE TIM
    
inherits:
    !include tim.yaml

properties:
    "#address-cells":
      type: int
      category: required
      description: should be 1.
    "#size-cells":
      type: int
      category: required
      description: should be 0.

    compatible:
      type: string
      category: required
      description: compatible strings
      constraint: "gree,gm-tim"

    label:
      type: string
      category: required
      description: Human readable string describing the device (used by uGelis for API name)
      generation: define

    reg:
      type: array
      description: mmio register space
      generation: define
      category: required

    clocks:
      type: array
      category: required
      description: Clock gate information
      generation: define

...
```

## ugelis/dts/bindings/watchdog/gree,gm-iwdg.yaml
```yaml
#
# Copyright (c) 2018, GREE
#
# SPDX-License-Identifier: Apache-2.0
#
---
title: GREE IWDG
id: gree,gm-iwdg
version: 0.1

description: >
    This binding gives a base representation of the GREE IWDG

properties:
    compatible:
      type: string
      category: required
      description: compatible strings
      constraint: "gree,gm-iwdg"

    reg:
      type: int
      description: mmio register space
      generation: define
      category: required

    label:
      type: string
      category: required
      description: string describing the device (used by Ugelis for API name)
      generation: define

    clocks:
      type: array
      category: required
      description: Clock gate control information
      generation: structures
...
```

## ugelis/ext/Kconfig
```kconfig
# Kconfig - external source code configuration options

#
# Copyright (c) 2016 Linaro Ltd.
#
# SPDX-License-Identifier: Apache-2.0
#

menu "External Sources"

source "ext/hal/Kconfig"

source "ext/lib/crypto/Kconfig"

source "ext/lib/encoding/Kconfig"

source "ext/lib/ipc/open-amp/Kconfig"

source "ext/lib/mgmt/Kconfig"

source "ext/debug/Kconfig"

source "ext/lib/openmv/Kconfig"

source "ext/lib/jerry-libm/Kconfig"

source "ext/lib/obj_info/Kconfig"

source "ext/lib/barcode/Kconfig"

source "ext/midware/easynet_cross/Kconfig"

endmenu
```

## ugelis/ext/lib/barcode/Kconfig
```kconfig
# Kconfig - the OpenMV project

#
# Copyright (c) 2015 Intel Corporation
#
# SPDX-License-Identifier: Apache-2.0
#

config BARCODE
	bool
	prompt "BarCode Support"
	default n
	help
	This option enables the BarCode library.

if BARCODE
config QR_DUAL_EN
	bool "qr dual en"
	default n
	help
	  This is an option to be enabled the dual core for qr code.
endif
```
