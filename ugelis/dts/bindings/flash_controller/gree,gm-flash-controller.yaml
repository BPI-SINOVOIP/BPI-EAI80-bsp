## ugelis/dts/bindings/flash_controller/gree,gm-flash-controller.yaml
```yaml
---
title: GREE SFLASH
id: gree,gm-flash-controller
version: 0.1

description: >
    This binding gives a base representation of the GREE SFLASH

inherits:
    !include flash-controller.yaml
properties:
    compatible:
      type: string
      category: required
      description: compatible strings
      constraint: "gree,gm-flash-controller"

    reg:
      type: array
      description: mmio register space
      generation: define
      category: required

    interrupts:
      type: array
      category: required
      description: required interrupts
      generation: define

    addr_space:
      type: array
      description: flash address space
      generation: define
      category: required
           
    readmode:
      type: int
      category: required
      description: sflash read mode
      generation: define
      
    bitmode:
      type: int
      category: required
      description: sflash transfor use line mode
      generation: define
    
    clkdiv:
      type: int
      category: required
      description: sflash clk div
      generation: define
     
...
```

## ugelis/dts/bindings/i2c/gree,gm-i2c.yaml
```yaml
---
title: GREE I2C
id: gree,gm-i2c
version: 0.1

description: >
    This binding gives a base representation of the GREE I2C

inherits:
    !include i2c.yaml

properties:
    compatible:
      type: string
      category: required
      description: compatible strings
      constraint: "gree,gm-i2c"

    reg:
      type: array
      description: mmio register space
      generation: define
      category: required

    interrupts:
      type: array
      category: required
      description: required interrupts
      generation: define

    interrupt-names:
      type: stringlist
      category: optional
      description: readable string describing the interrupts
      generation: define
...
```

## ugelis/dts/bindings/input/gree,ts-ft5426.yaml
```yaml
---
title: TS_FT5426
id: gree,ts-ft5426
version: 0.1

description: >
      This binding gives a base representation of touchscreen device(ft5426)

properties:
    compatible:
      type: string
      category: required
      description: compatible strings
      constraint: "gree,ts-ft5426"

    label:
      type: string
      category: required
      description: Human readable string describing the device (used by Ugelis for API name)
      generation: define
...
```

## ugelis/dts/bindings/input/gree,ts-gt911.yaml
```yaml
---
title: TS_GT911
id: gree,ts-gt911
version: 0.1

description: >
      This binding gives a base representation of touchscreen device(gt911)

properties:
    compatible:
      type: string
      category: required
      description: compatible strings
      constraint: "gree,ts-gt911"

    ts_rst_port:
      type: stringlist
      category: optional
      description: ov5640 reset gpio port
      generation: define
      
    ts_rst_pin:
      type: stringlist
      category: optional
      description: ov5640 reset gpio port
      generation: define
      
    ts_int_port:
      type: stringlist
      category: optional
      description: ov5640 reset gpio port
      generation: define
      
    ts_int_pin:
      type: stringlist
      category: optional
      description: ov5640 reset gpio port
      generation: define
      
    label:
      type: string
      category: required
      description: Human readable string describing the device (used by Ugelis for API name)
      generation: define
...
```

## ugelis/dts/bindings/input/gree,ts-gt9147.yaml
```yaml
---
title: TS_GT9147
id: gree,ts-gt9147
version: 0.1

description: >
      This binding gives a base representation of touchscreen device(gt9147)

properties:
    compatible:
      type: string
      category: required
      description: compatible strings
      constraint: "gree,ts-gt9147"

    label:
      type: string
      category: required
      description: Human readable string describing the device (used by Ugelis for API name)
      generation: define
...
```

## ugelis/dts/bindings/lvd/gree,gm-lvd.yaml
```yaml
#
# Copyright (c) 2018, GREE
#
# SPDX-License-Identifier: Apache-2.0
#
---
title: GREE LVD
id: gree,gm-lvd
version: 0.1

description: >
    This binding gives a base representation of the GREE LVD


properties:
    compatible:
      type: string
      category: required
      description: compatible strings
      constraint: "gree,gm-lvd"

    reg:
      type: array
      description: mmio register space
      generation: define
      category: required

    label:
      type: string
      category: required
      generation: define
      description: string describing the device (used by Ugelis for API name)

    interrupts:
      type: array
      category: required
      description: required interrupts
      generation: define

    clocks:
      type: array
      category: required
      description: Clock gate control information
      generation: structures
...
```

## ugelis/dts/bindings/lvd/lvd.yaml
```yaml
#
# Copyright (c) 2018, blik GmbH
#
# SPDX-License-Identifier: Apache-2.0
#
---
title: LVD Base Structure
id: 
version: 0.1

description: >
    This binding gives the base structures for all LVD devices


properties:
    clock-frequency:
      type: int
      category: optional
      description: Clock frequency information for LVD operation
      generation: define
    label:
      type: string
      category: required
      description: Human readable string describing the device (used by uGelis for API name)
      generation: define
    interrupts:
      type: array
      category: required
      description: required interrupts
      generation: define
    interrupt-names:
      type: stringlist
      category: optional
      description: names of required interrupts
      generation: define
    prescaler:
      type: int
      category: required
      description: Prescaler value 
      generation: define
...
```

## ugelis/dts/bindings/media/gree,camera-bf3007.yaml
```yaml
---
title: CAMERA_BF3007
id: gree,camera-bf3007
version: 0.1

description: >
      This binding gives a base representation of camera sensor(bf3007)

properties:
    compatible:
      type: string
      category: required
      description: compatible strings
      constraint: "gree,camera-bf3007"

    gpio_rst_port:
      type: stringlist
      category: optional
      description: bf3007 reset gpio port
      generation: define

    gpio_rst_pin:
      type: int
      category: required
      description: bf3007 reset gpio pin
      generation: define

    gpio_pwdn_port:
      type: stringlist
      category: optional
      description: bf3007 pwdn gpio port
      generation: define

    gpio_pwdn_pin:
      type: int
      category: required
      description: bf3007 pwdn gpio pin
      generation: define
      
    gpio_scl_port:
      type: stringlist
      category: optional
      description: bf3007 sccb scl port
      generation: define

    gpio_scl_pin:
      type: int
      category: required
      description: bf3007 sccb scl pin
      generation: define

    gpio_sda_port:
      type: stringlist
      category: optional
      description: bf3007 sccb sda port
      generation: define

    gpio_sda_pin:
      type: int
      category: required
      description: bf3007 sccb sda pin
      generation: define

    pclk_polarity:
      type: int
      category: required
      description: pixel clock polarity
      generation: define

    hsync_polarity:
      type: int
      category: required
      description: horizontal synchronization polarity
      generation: define

    vsync_polarity:
      type: int
      category: required
      description: vertical synchronization polarity
      generation: define

    label:
      type: string
      category: required
      description: Human readable string describing the device (used by Ugelis for API name)
      generation: define
...
```

## ugelis/dts/bindings/media/gree,camera-gc0308.yaml
```yaml
---
title: CAMERA_GC0308
id: gree,camera-gc0308
version: 0.1

description: >
      This binding gives a base representation of camera sensor(gc0308)

properties:
    compatible:
      type: string
      category: required
      description: compatible strings
      constraint: "gree,camera-gc0308"

    gpio_rst_port:
      type: stringlist
      category: optional
      description: gc0308 reset gpio port
      generation: define

    gpio_rst_pin:
      type: int
      category: required
      description: gc0308 reset gpio pin
      generation: define

    gpio_pwdn_port:
      type: stringlist
      category: optional
      description: gc0308 pwdn gpio port
      generation: define

    gpio_pwdn_pin:
      type: int
      category: required
      description: gc0308 pwdn gpio pin
      generation: define
      
    gpio_scl_port:
      type: stringlist
      category: optional
      description: gc0308 sccb scl port
      generation: define

    gpio_scl_pin:
      type: int
      category: required
      description: gc0308 sccb scl pin
      generation: define

    gpio_sda_port:
      type: stringlist
      category: optional
      description: gc0308 sccb sda port
      generation: define

    gpio_sda_pin:
      type: int
      category: required
      description: gc0308 sccb sda pin
      generation: define

    pclk_polarity:
      type: int
      category: required
      description: pixel clock polarity
      generation: define

    hsync_polarity:
      type: int
      category: required
      description: horizontal synchronization polarity
      generation: define

    vsync_polarity:
      type: int
      category: required
      description: vertical synchronization polarity
      generation: define

    label:
      type: string
      category: required
      description: Human readable string describing the device (used by Ugelis for API name)
      generation: define
...
```

## ugelis/dts/bindings/media/gree,camera-ov5640.yaml
```yaml
---
title: CAMERA_OV5640
id: gree,camera-ov5640
version: 0.1

description: >
      This binding gives a base representation of camera sensor(ov5640)

properties:
    compatible:
      type: string
      category: required
      description: compatible strings
      constraint: "gree,camera-ov5640"

    gpio_rst_port:
      type: stringlist
      category: optional
      description: ov5640 reset gpio port
      generation: define

    gpio_rst_pin:
      type: int
      category: required
      description: ov5640 reset gpio pin
      generation: define

    gpio_pwdn_port:
      type: stringlist
      category: optional
      description: ov5640 pwdn gpio port
      generation: define

    gpio_pwdn_pin:
      type: int
      category: required
      description: ov5640 pwdn gpio pin
      generation: define
      
    gpio_scl_port:
      type: stringlist
      category: optional
      description: ov5640 sccb scl port
      generation: define

    gpio_scl_pin:
      type: int
      category: required
      description: ov5640 sccb scl pin
      generation: define

    gpio_sda_port:
      type: stringlist
      category: optional
      description: ov5640 sccb sda port
      generation: define

    gpio_sda_pin:
      type: int
      category: required
      description: ov5640 sccb sda pin
      generation: define
      
    pclk_polarity:
      type: int
      category: required
      description: pixel clock polarity
      generation: define

    hsync_polarity:
      type: int
      category: required
      description: horizontal synchronization polarity
      generation: define

    vsync_polarity:
      type: int
      category: required
      description: vertical synchronization polarity
      generation: define

    label:
      type: string
      category: required
      description: Human readable string describing the device (used by Ugelis for API name)
      generation: define
...
```

## ugelis/dts/bindings/media/gree,camera-sccb.yaml
```yaml
---
title: CAMERA_SCCB
id: gree,camera-sccb
version: 0.1

description: >
      This binding gives a base representation of camera sccb protocal

properties:
    compatible:
      type: string
      category: required
      description: compatible strings
      constraint: "gree,camera-sccb"

    gpio_scl_port:
      type: stringlist
      category: optional
      description: ov7725 sccb scl port
      generation: define

    gpio_scl_pin:
      type: int
      category: required
      description: ov7725 sccb scl pin
      generation: define

    gpio_sda_port:
      type: stringlist
      category: optional
      description: ov7725 sccb sda port
      generation: define

    gpio_sda_pin:
      type: int
      category: required
      description: ov7725 sccb sda pin
      generation: define
      
    label:
      type: string
      category: required
      description: Human readable string describing the device (used by Ugelis for API name)
      generation: define
...
```

## ugelis/dts/bindings/media/gree,gm-imp.yaml
```yaml
---
title: GM6721X IMP
id: gree,gm-imp
version: 0.1

description: >
    This binding gives a base representation of the GM6721X IMP

properties:
    compatible:
      type: string
      category: required
      description: compatible strings
      constraint: "gree,gm-imp"

    reg:
      type: array
      description: mmio register space
      generation: define
      category: required

    interrupts:
      type: array
      category: required
      description: required interrupts
      generation: define

    clocks:
      type: array
      category: required
      description: Clock gate control information
      generation: define
...
```

## ugelis/dts/bindings/media/gree,gm-vin.yaml
```yaml
---
title: GM6721X VIN
id: gree,gm-vin
version: 0.1

description: >
    This binding gives a base representation of the GM6721X VIN

properties:
    compatible:
      type: string
      category: required
      description: compatible strings
      constraint: "gree,gm-vin"

    reg:
      type: array
      description: mmio register space
      generation: define
      category: required

    interrupts:
      type: array
      category: required
      description: required interrupts
      generation: define

    label:
      type: string
      category: required
      description: Human readable string describing the device (used by Ugelis for API name)
      generation: define
...
```
