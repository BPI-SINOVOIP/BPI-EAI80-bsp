/*
 * Basic Device Tree overlay file for chain-loading by MCUboot.
 * Automatically pulled in when CONFIG_BOOTLOADER_MCUBOOT is set.
 */

/ {
	chosen {
		ugelis,code-partition = &slot0_partition;
	};
};
