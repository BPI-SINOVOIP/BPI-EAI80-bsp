## ugelis/arch/arm/Kconfig
```kconfig
# Kconfig - ARM architecture configuration options

#
# Copyright (c) 2014-2015 Wind River Systems, Inc.
#
# SPDX-License-Identifier: Apache-2.0
#

choice
	prompt "ARM SoC Selection"
	depends on ARM

	gsource "arch/arm/soc/*/Kconfig.soc"
endchoice

menu "ARM Options"
	depends on ARM

config ARCH
	default "arm"

config ARCH_DEFCONFIG
	string
	default "arch/arm/defconfig"


source "arch/arm/core/Kconfig"

menu "SoC Configuration"

gsource "arch/arm/soc/*/Kconfig"

endmenu
endmenu
```

## ugelis/arch/arm/soc/gree_gm/Kconfig
```kconfig
# Kconfig - GREE Microelectronics GM MCU line
#
# Copyright (c) 2016 Open-RnD Sp. z o.o.
#
# SPDX-License-Identifier: Apache-2.0
#

config SOC_FAMILY_GM
	bool
	# omit prompt to signify a "hidden" option
	default n


if SOC_FAMILY_GM

config SOC_FAMILY
	string
    default "gree_gm"

config GM_ARM_MPU_ENABLE
	bool "Enable MPU on GM"
	depends on CPU_HAS_MPU
	select ARM_MPU
	default n
	help
	  Enable MPU support on GM SoCs

gsource "arch/arm/soc/gree_gm/*/Kconfig.soc"

endif # SOC_FAMILY_GM
```

## ugelis/arch/arm/soc/gree_gm/gm6721x/Kconfig.defconfig.f6721b
```kconfig
# Kconfig - GREE Microelectronics F6721B MCU
#
# Copyright (c) 2018 Linaro Limited.
#

if SOC_F6721B

config SOC
	string
	default "f6721b"

endif # SOC_F6721B
```

## ugelis/arch/arm/soc/gree_gm/gm6721x/Kconfig.defconfig.gm6721
```kconfig
# Kconfig - GREE Microelectronics GM6721 MCU
#
# Copyright (c) 2018 Linaro Limited.
#

if SOC_GM6721

config SOC
	string
	default "gm6721"

endif # SOC_GM6721
```

## ugelis/arch/arm/soc/gree_gm/gm6721x/Kconfig.defconfig.gm6721x
```kconfig
# Kconfig - GREE Microelectronics GM6721X MCU
#
# Copyright (c) 2018 Linaro Limited.
#


config NUM_IRQS
	int
	default 80

gsource "arch/arm/soc/gree_gm/gm6721x/Kconfig.defconfig.f6721b"
gsource "arch/arm/soc/gree_gm/gm6721x/Kconfig.defconfig.gm6721"
```

## ugelis/arch/arm/soc/gree_gm/gm6721x/Kconfig.defconfig.series
```kconfig
# Kconfig.defconfig.series - ST Microelectronics STM32F4 MCU line
#
# Copyright (c) 2016 Linaro Limited
#
# SPDX-License-Identifier: Apache-2.0
#

if SOC_SERIES_GM6721X

gsource "arch/arm/soc/gree_gm/gm6721x/Kconfig.defconfig.gm6721x"


config SOC_SERIES
        string
        default "gm6721x"

endif # SOC_SERIES_GM6721X
```

## ugelis/arch/arm/soc/gree_gm/gm6721x/Kconfig.series
```kconfig
# Kconfig - ST Microelectronics GM6721X MCU series
#
# Copyright (c) 2018 Linaro Limited
#
# SPDX-License-Identifier: Apache-2.0
#

config SOC_SERIES_GM6721X
	bool "GM6721X Series MCU"
	select CPU_CORTEX_M4
	select CPU_HAS_FPU
	select SOC_FAMILY_GM
	#select SYS_POWER_LOW_POWER_STATE_SUPPORTED
	select HAS_GM_HAL
	select CPU_HAS_MPU
	select CPU_HAS_SYSTICK
    select FLOAT
    select FP_SHARING



	help
	 Enable support for GM6721X MCU series
```

## ugelis/arch/arm/soc/gree_gm/gm6721x/Kconfig.soc
```kconfig
# Kconfig.soc - ST Microelectronics GM6721X MCU line
#
# Copyright (c) 2018 Linaro Limited.
#
# SPDX-License-Identifier: Apache-2.0
#

choice
prompt "GM6721X MCU Selection"
depends on SOC_SERIES_GM6721X

config SOC_GM6721
	bool "GM6721"

config SOC_F6721B
	bool "F6721B"


##########add other 6721x serial soc late###########
    
endchoice
```

## ugelis/boards/arm/banpiboard_qfn80pin/Kconfig.board
```kconfig
# Kconfig - BANPIBOARD-QFN80PIN board configuration
#
# Copyright (c) 2016 Linaro Limited.
#
# SPDX-License-Identifier: Apache-2.0
#

config BOARD_BANPIBOARD_QFN80PIN
	bool "BANPIBOARD-QFN80PIN Development Board"
	depends on SOC_F6721B
```

## ugelis/boards/arm/banpiboard_qfn80pin/Kconfig.defconfig
```kconfig
# Kconfig - BANPIBOARD-QFN80PIN board configuration
#
# Copyright (c) 2016 Linaro Limited.
#
# SPDX-License-Identifier: Apache-2.0
#

if BOARD_BANPIBOARD_QFN80PIN

config BOARD
	default "banpiboard_qfn80pin"


endif # BOARD_BANPIBOARD_QFN80PIN
```

## ugelis/boards/arm/bpi_eai80_qfn80pin/Kconfig.board
```kconfig
# Kconfig - BPI_EAI80-QFN80PIN board configuration
#
# Copyright (c) 2016 Linaro Limited.
#
# SPDX-License-Identifier: Apache-2.0
#

config BOARD_BPI_EAI80_QFN80PIN
	bool "BPI-EAI80--QFN80PIN Development Board"
	depends on SOC_F6721B
```

## ugelis/boards/arm/bpi_eai80_qfn80pin/Kconfig.defconfig
```kconfig
# Kconfig - BPI-EAI80-QFN80PIN board configuration
#
# Copyright (c) 2016 Linaro Limited.
#
# SPDX-License-Identifier: Apache-2.0
#

if BOARD_BPI_EAI80_QFN80PIN

config BOARD
	default "bpi_eai80_qfn80pin"


endif # BOARD_BPI_EAI80_QFN80PIN
```

## ugelis/boards/arm/f6721b_evb_144pin/Kconfig.board
```kconfig
# Kconfig - GM6721-EVB-144Pin board configuration
#
# Copyright (c) 2016 Linaro Limited.
#
# SPDX-License-Identifier: Apache-2.0
#

config BOARD_F6721B_EVB_144PIN
	bool "F6721B-EVB-144PIN Development Board"
	depends on SOC_F6721B
```

## ugelis/boards/arm/f6721b_evb_144pin/Kconfig.defconfig
```kconfig
# Kconfig - GM6721-EVB-144PIN board configuration
#
# Copyright (c) 2016 Linaro Limited.
#
# SPDX-License-Identifier: Apache-2.0
#

if BOARD_F6721B_EVB_144PIN

config BOARD
	default "f6721b_evb_144pin"


endif # BOARD_F6721B_EVB_144PIN
```

## ugelis/boards/arm/f6721b_evb_144pin/f6721b_evb_144pin_defconfig
```kconfig
CONFIG_ARM=y

CONFIG_BOARD_F6721B_EVB_144PIN=y
CONFIG_SOC_SERIES_GM6721X=y
CONFIG_SOC_F6721B=y

#
# Compiler Options
#
CONFIG_CROSS_COMPILE=""
CONFIG_DEBUG_OPTIMIZATIONS=y
CONFIG_COMPILER_OPT=""

# 150MHz system clock
CONFIG_SYS_CLOCK_HW_CYCLES_PER_SEC=200000000
CONFIG_SYS_CLOCK_TICKS_PER_SEC=1000

# Enable MPU
#CONFIG_GM_ARM_MPU_ENABLE=y

# Kernel Options
CONFIG_MAIN_STACK_SIZE=2048
CONFIG_IDLE_STACK_SIZE=2048
CONFIG_ISR_STACK_SIZE=1024


# Memory Pool Options
CONFIG_HEAP_MEM_POOL_SIZE=8192





# console
CONFIG_CONSOLE=y
CONFIG_SERIAL=y
CONFIG_UART_CONSOLE=y

# enable pinmux

# enable PINMUX
CONFIG_PINMUX=y
CONFIG_PINMUX_NAME="PINMUX"
CONFIG_PINMUX_INIT_PRIORITY=45
CONFIG_PINMUX_GM=y
CONFIG_PINMUX_GM_PORTA=y
CONFIG_PINMUX_GM_PORTA_NAME="porta"
CONFIG_PINMUX_GM_PORTB=y
CONFIG_PINMUX_GM_PORTB_NAME="portb"
CONFIG_PINMUX_GM_PORTC=y
CONFIG_PINMUX_GM_PORTC_NAME="portc"
CONFIG_PINMUX_GM_PORTD=y
CONFIG_PINMUX_GM_PORTD_NAME="portd"
CONFIG_PINMUX_GM_PORTE=y
CONFIG_PINMUX_GM_PORTE_NAME="porte"
CONFIG_PINMUX_GM_PORTF=y
CONFIG_PINMUX_GM_PORTF_NAME="portf"
CONFIG_PINMUX_GM_PORTG=y
CONFIG_PINMUX_GM_PORTG_NAME="portg"
CONFIG_PINMUX_GM_PORTH=y
CONFIG_PINMUX_GM_PORTH_NAME="porth"
CONFIG_PINMUX_GM_PORTI=y
CONFIG_PINMUX_GM_PORTI_NAME="porti"
CONFIG_PINMUX_GM_PORTJ=y
CONFIG_PINMUX_GM_PORTJ_NAME="portj"
CONFIG_PINMUX_GM_PORTK=y
CONFIG_PINMUX_GM_PORTK_NAME="portk"
# enable GPIO

CONFIG_GPIO=y

CONFIG_GPIO_GM=y
CONFIG_GPIO_GM_A=y
CONFIG_GPIO_GM_A_NAME="GPIOA"
CONFIG_GPIO_GM_A_IRQ_PRI=1
CONFIG_GPIO_GM_B=y
CONFIG_GPIO_GM_B_NAME="GPIOB"
CONFIG_GPIO_GM_B_IRQ_PRI=1
CONFIG_GPIO_GM_C=y
CONFIG_GPIO_GM_C_NAME="GPIOC"
CONFIG_GPIO_GM_C_IRQ_PRI=1
CONFIG_GPIO_GM_D=y
CONFIG_GPIO_GM_D_NAME="GPIOD"
CONFIG_GPIO_GM_D_IRQ_PRI=1
CONFIG_GPIO_GM_E=y
CONFIG_GPIO_GM_E_NAME="GPIOE"
CONFIG_GPIO_GM_E_IRQ_PRI=1
CONFIG_GPIO_GM_F=y
CONFIG_GPIO_GM_F_NAME="GPIOF"
CONFIG_GPIO_GM_F_IRQ_PRI=1
CONFIG_GPIO_GM_G=y
CONFIG_GPIO_GM_G_NAME="GPIOG"
CONFIG_GPIO_GM_G_IRQ_PRI=1
CONFIG_GPIO_GM_H=y
CONFIG_GPIO_GM_H_NAME="GPIOH"
CONFIG_GPIO_GM_H_IRQ_PRI=1
CONFIG_GPIO_GM_I=y
CONFIG_GPIO_GM_I_NAME="GPIOI"
CONFIG_GPIO_GM_I_IRQ_PRI=1
CONFIG_GPIO_GM_J=y
CONFIG_GPIO_GM_J_NAME="GPIOJ"
CONFIG_GPIO_GM_J_IRQ_PRI=1
CONFIG_GPIO_GM_K=y
CONFIG_GPIO_GM_K_NAME="GPIOK"
CONFIG_GPIO_GM_K_IRQ_PRI=1

# clock configuration
#CONFIG_CLOCK_CONTROL=y

# basic enable gree hal
CONFIG_HAS_GM_HAL=y
CONFIG_GM_HAL_GPIO=y
CONFIG_GM_HAL_UART=y
#power manage
#CONFIG_PM=y
#CONFIG_POWER_GM=y
#CONFIG_GM_HAL_POWER=y
#CONFIG_DEVICE_POWER_MANAGEMENT=y

########cpu config#######
CONFIG_GM_HAL_CPU=y
CONFIG_GM_HAL_CACHE=y


##### memory resever ####
CONFIG_KERNEL_MEM_RESVER_SIZE=6144

###### C Library#######
CONFIG_STDOUT_CONSOLE=y

######For Ztest#######
#CONFIG_TEST_EXTRA_STACKSIZE=2048
```

## ugelis/boards/arm/f6721b_evb_176pin/Kconfig.board
```kconfig
# Kconfig - F6721B-EVB-176Pin board configuration
#
# Copyright (c) 2016 Linaro Limited.
#
# SPDX-License-Identifier: Apache-2.0
#

config BOARD_F6721B_EVB_176PIN
	bool "F6721B-EVB-176PIN Development Board"
	depends on SOC_F6721B
```

## ugelis/boards/arm/f6721b_evb_176pin/Kconfig.defconfig
```kconfig
# Kconfig - F6721B-EVB-176PIN board configuration
#
# Copyright (c) 2016 Linaro Limited.
#
# SPDX-License-Identifier: Apache-2.0
#

if BOARD_F6721B_EVB_176PIN

config BOARD
	default "f6721b_evb_176pin"


endif # BOARD_F6721B_EVB_176PIN
```

## ugelis/boards/arm/f6721b_evb_qfn40Pin/Kconfig.board
```kconfig
# Kconfig - F6721B-EVB-QFN40Pin board configuration
#
# Copyright (c) 2016 Linaro Limited.
#
# SPDX-License-Identifier: Apache-2.0
#

config BOARD_F6721B_EVB_QFN40PIN
	bool "F6721B-EVB-QFN40PIN Development Board"
	depends on SOC_F6721B
```

## ugelis/boards/arm/f6721b_evb_qfn40Pin/Kconfig.defconfig
```kconfig
# Kconfig - F6721B-EVB-QFN40PIN board configuration
#
# Copyright (c) 2016 Linaro Limited.
#
# SPDX-License-Identifier: Apache-2.0
#

if BOARD_F6721B_EVB_QFN40PIN

config BOARD
	default "f6721b_evb_qfn40pin"


endif # BOARD_F6721B_EVB_QFN40PIN
```

## ugelis/boards/arm/f6721b_evb_qfn80Pin/Kconfig.defconfig
```kconfig
# Kconfig - F6721B-EVB-QFN80PIN board configuration
#
# Copyright (c) 2016 Linaro Limited.
#
# SPDX-License-Identifier: Apache-2.0
#

if BOARD_F6721B_EVB_QFN80PIN

config BOARD
	default "f6721b_evb_qfn80pin"


endif # BOARD_F6721B_EVB_QFN80PIN
```

## ugelis/drivers/Kconfig
```kconfig
# Kconfig - drivers configuration options

#
# Copyright (c) 2015 Intel Corporation
#
# SPDX-License-Identifier: Apache-2.0
#


menu "Device Drivers"

source "drivers/console/Kconfig"

source "drivers/serial/Kconfig"

source "drivers/interrupt_controller/Kconfig"

source "drivers/timer/Kconfig"

source "drivers/entropy/Kconfig"

source "drivers/grove/Kconfig"

source "drivers/pci/Kconfig"

source "drivers/gpio/Kconfig"

source "drivers/interrupt_controller/Kconfig.shared_irq"

source "drivers/spi/Kconfig"

source "drivers/i2c/Kconfig"

source "drivers/i2s/Kconfig"

source "drivers/pdm/Kconfig"

source "drivers/tim/Kconfig"

source "drivers/pinmux/Kconfig"

source "drivers/adc/Kconfig"

source "drivers/rtc/Kconfig"

source "drivers/lvd/Kconfig"

source "drivers/watchdog/Kconfig"

source "drivers/clock_control/Kconfig"

source "drivers/ptp_clock/Kconfig"

source "drivers/ipm/Kconfig"

source "drivers/aio/Kconfig"

source "drivers/flash/Kconfig"

source "drivers/sensor/Kconfig"

source "drivers/counter/Kconfig"

source "drivers/dma/Kconfig"

source "drivers/usb/Kconfig"

source "drivers/crypto/Kconfig"

source "drivers/display/Kconfig"

source "drivers/led_strip/Kconfig"

source "drivers/led/Kconfig"

source "drivers/can/Kconfig"

source "drivers/camera/Kconfig"

source "drivers/mmc/Kconfig"

source "drivers/key/Kconfig"
source "drivers/acmp/Kconfig"
source "drivers/dac/Kconfig"

source "drivers/pm/Kconfig"

source "drivers/input/Kconfig"
endmenu
```

## ugelis/drivers/acmp/Kconfig
```kconfig
# Kconfig - ACMP configuration options

#
# Copyright (c) 2015 Intel Corporation
#
# SPDX-License-Identifier: Apache-2.0
#

#
# ACMP options
#
menuconfig ACMP
	bool
	prompt "ACMP drivers"
	help
	  Enable ACMP (Analog to Digital Converter) driver configuration

if ACMP

config SYS_LOG_ADC_LEVEL
	int
	prompt "ACMP drivers log level"
	depends on ACMP
	default 0
	range 0 4
	help

	  Sets log level for ACMP driver.

	  Levels are:

	  - 0 OFF, do not write

	  - 1 ERROR, only write SYS_LOG_ERR

	  - 2 WARNING, write SYS_LOG_WRN in addition to previous level

	  - 3 INFO, write SYS_LOG_INF in addition to previous levels

	  - 4 DEBUG, write SYS_LOG_DBG in addition to previous levels

config ACMP_INIT_PRIORITY
	int
	default 80
	prompt "Init priority"
	help
	  ACMP Device driver initialization priority.

config ACMP_0
	bool "Enable ACMP 0"

config ACMP_0_NAME
	string "ACMP 0 Driver's name"
	depends on ACMP_0
	default "ACMP_0"

config ACMP_0_IRQ_PRI
	int
	depends on ACMP_0
	prompt "ACMP 0 interrupt priority"
	default 2

source "drivers/acmp/Kconfig.gm"

endif # ACMP
```

## ugelis/drivers/acmp/Kconfig.gm
```kconfig
# Kconfig - ADC configuration options

#
# Copyright (c) 2015 Intel Corporation
#
# SPDX-License-Identifier: Apache-2.0
#




menuconfig ACMP_GM
	bool
    prompt   "ACMP Gree Driver"
	default y
	select ACMP_0
	help
	  Enable the driver implementation of the Designware ACMP IP.
```
