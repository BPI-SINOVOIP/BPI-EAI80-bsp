## prj.conf
```kconfig
# nothing here

CONFIG_SCHED_MULTIQ=y
CONFIG_XIP=n
CONFIG_SDRAM_BOOT=y


CONFIG_RTC=y
CONFIG_RTC_GM=y
CONFIG_GM_HAL_RTC=y

#debug pm not enter low power mode
CONFIG_PM_DEBUG=n

#power manage
CONFIG_PM=y
CONFIG_POWER_GM=y
CONFIG_GM_HAL_POWER=y
CONFIG_DEVICE_POWER_MANAGEMENT=y
```

## src/main.c
```c
/*
 * Copyright (c) 2012-2014 Wind River Systems, Inc.
 *
 * SPDX-License-Identifier: Apache-2.0
 */

#include <ugelis.h>
#include <kernel_structs.h>

#include <misc/printk.h>
#include <pm.h>


#define PM_DEAD_LOOP()  do{}while(1)


void main(void)
{
    int ret = 0;

    while (1)
    {

        printk("###sys entr low power mode###\n");
        k_sleep(3000);
        pm_config_rtc_wakeup_time(0);
        ret = pm_entry_low_power(SHUTDOWN_MODE);
        if (ret)
        {
            printk("Err:%d pm_entry_lower_power\n", ret);
            PM_DEAD_LOOP();
        }
        printk("resume back!!\n");
        k_sleep(3000);

    }



}
```
