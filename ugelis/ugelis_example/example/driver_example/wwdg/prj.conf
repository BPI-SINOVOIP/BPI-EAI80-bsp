## CMakeLists.txt
```
set(BOARD f6721b_evb_176pin)
include($ENV{UGELIS_BASE}/cmake/app/boilerplate.cmake NO_POLICY_SCOPE)
project(NONE)

target_sources(app PRIVATE src/main.c)
```

## sample.yaml
```
sample:
  name: wwdg
  description:  wwdg sample normal and earlying warning iterrupt mode
tests:
  test.normal:
    platform_whitelist:  gm6721_evb_176pin gm6721_evb_144pin gm6721_evb_qfn80pin gm6721_evb_qfn40pin
    extra_args: CONF_FILE=prj_normal.conf
    tags: samples
  test.normal_ewi:
    platform_whitelist:  gm6721_evb_176pin gm6721_evb_144pin gm6721_evb_qfn80pin gm6721_evb_qfn40pin
    extra_args: CONF_FILE=prj_normal_ewi.conf
    tags: samples
```

## prj.conf
```kconfig
CONFIG_XIP=n        #if the program run in sram ,donn't set other
CONFIG_SDRAM_BOOT=y #if the program run in sdram ,please set 
CONFIG_WATCHDOG=y
CONFIG_WWDG_GM=y
CONFIG_WWDG_GM_DEVICE_NAME="WWDG"
CONFIG_GM_HAL_WWDG=y
CONFIG_WWDG_GM_RELOAD_COUNTER=5000
CONFIG_WWDG_GM_WINDOW_VALUE=3000
CONFIG_WWDG_GM_MODE=0
CONFIG_WWDG_GM_WINLEN=15
CONFIG_WWDG_GM_DIV_FACTOR=31
```

## prj_normal.conf
```kconfig
CONFIG_XIP=n        #if the program run in sram ,donn't set other
CONFIG_SDRAM_BOOT=y #if the program run in sdram ,please set CONFIG_XIP=n and CONFIG_SDRAM_BOOT=y
CONFIG_WATCHDOG=y
CONFIG_WWDG_GM=y
CONFIG_WWDG_GM_DEVICE_NAME="WWDG"
CONFIG_GM_HAL_WWDG=y
CONFIG_WWDG_GM_RELOAD_COUNTER=5000
CONFIG_WWDG_GM_WINDOW_VALUE=3000
CONFIG_WWDG_GM_MODE=0
CONFIG_WWDG_GM_WINLEN=15
CONFIG_WWDG_GM_DIV_FACTOR=31
```

## prj_normal_ewi.conf
```kconfig
CONFIG_XIP=n        #if the program run in sram ,donn't set other
CONFIG_SDRAM_BOOT=y #if the program run in sdram ,please set CONFIG_XIP=n and CONFIG_SDRAM_BOOT=y
CONFIG_WATCHDOG=y
CONFIG_WWDG_GM=y
CONFIG_WWDG_GM_DEVICE_NAME="WWDG"
CONFIG_GM_HAL_WWDG=y
CONFIG_WWDG_GM_RELOAD_COUNTER=5000
CONFIG_WWDG_GM_WINDOW_VALUE=3000
CONFIG_WWDG_GM_MODE=2
CONFIG_WWDG_GM_WINLEN=15
CONFIG_WWDG_GM_DIV_FACTOR=31
```

## src/main.c
```c
/*
 * Copyright (c) 2015 Intel Corporation
 *
 * SPDX-License-Identifier: Apache-2.0
 */

#include <ugelis.h>

#include <device.h>
#include <watchdog.h>
#include "board.h"
#include <misc/printk.h>


#define RESET_TIME    CONFIG_WWDG_GM_RELOAD_COUNTER
#define WINDOW_TIME   CONFIG_WWDG_GM_WINDOW_VALUE

/* WDT Requires a callback, there is no interrupt enable / disable. */
void wdt_example_cb(WDOG_Handle_T *hWDOG, WDOG_Event_T event, ulong_t Param)
{
    ARG_UNUSED(hWDOG);
    printk("Waiting to return main\n");
}

void main(void)
{

    struct wdt_config wr_cfg;
    struct device *wdt_dev;
    uint32_t  cnt = 0;

    cnt = 5;

    printf("wwdg status bit1:0x%x\n", (*(volatile uint32_t *)(0x40000004)));
    /*clear reset iwdg  status bit*/
    *(volatile uint32_t *)(0x40000004) |= (1 << 1);
    printf("clear wwdg status bit1:0x%x\n", (*(volatile uint32_t *)(0x40000004)));

    printk("Start wwdg test,sysclk:%d\n", SYS_CLOCK);
    k_sleep(1000);

    wdt_dev = device_get_binding("WWDG");
    if (!wdt_dev)
    {
        printk("Cann't get GM-WWDG Device\n");
    }

    wr_cfg.timeout = RESET_TIME;
    wr_cfg.windowtimeout = WINDOW_TIME;
    wr_cfg.workmode = CONFIG_WWDG_GM_MODE;
    wr_cfg.clkdiv = CONFIG_WWDG_GM_DIV_FACTOR;

    if (wr_cfg.workmode == WWDG_NORMAL_EWI)
    {
        wr_cfg.mode = WDT_MODE_INTERRUPT_RESET;
        wr_cfg.winLen = CONFIG_WWDG_GM_WINLEN;         /*normal_ewi or window_ewi mode,it must set winlen*/
        wr_cfg.interrupt_fn = wdt_example_cb;
    }
    else
    {
        wr_cfg.mode = WDT_MODE_RESET;
        wr_cfg.winLen = CONFIG_WWDG_GM_WINLEN;        /*normal or window mode,it may set winlen*/
        wr_cfg.interrupt_fn = NULL;
    }
    wdt_set_config(wdt_dev, &wr_cfg);
    wdt_enable(wdt_dev);


    do
    {
        printk("waiting for .....!\n");
        k_sleep(1000);
        /*if you already had configed WWDG support EWI interrupt
          in makemenuconfig,the flow cann't run */
        printk("feedwdg\n");
        wdt_reload(wdt_dev);

    } while (cnt--);
    printk("waiting for wwdg reset!\n");
    while (1);
}
```
