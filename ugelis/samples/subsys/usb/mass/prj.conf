## prj.conf
```kconfig
CONFIG_STDOUT_CONSOLE=y
CONFIG_SYS_LOG=y
CONFIG_SYS_LOG_DEFAULT_LEVEL=1
CONFIG_ARC_INIT=n
CONFIG_GPIO=y

#USB related configs
CONFIG_USB=y
CONFIG_USB_DEVICE_STACK=y
CONFIG_USB_DEVICE_PRODUCT="uGelis MSC sample"
CONFIG_SYS_LOG_USB_DRIVER_LEVEL=1
CONFIG_USB_MASS_STORAGE=y
CONFIG_SYS_LOG_USB_DEVICE_LEVEL=1
CONFIG_SYS_LOG_USB_MASS_STORAGE_LEVEL=1

# If the target's code needs to do file operations, enable target's
# FAT FS code. (Without this only the host can access the fs contents)
#CONFIG_FILE_SYSTEM=y

#SPI flash related configs
CONFIG_DISK_ACCESS_FLASH=y
CONFIG_MASS_STORAGE_DISK_NAME="NAND"
CONFIG_SPI=y

#Want RAM DISK instead ? comment the whole flash block and uncomment
#CONFIG_DISK_ACCESS_RAM=y
#CONFIG_MASS_STORAGE_DISK_NAME="RAM"
```

## src/main.c
```c
/*
 * Copyright (c) 2016 Intel Corporation.
 *
 * SPDX-License-Identifier: Apache-2.0
 */

/* Sample to put the device in USB mass storage mode backed on a 16k RAMDisk. */

#include <ugelis.h>
#include <logging/sys_log.h>

void main(void)
{
	/* Nothing to be done other than the selecting appropriate build
	 * config options. Everything is driven from the USB host side.
	 */
	SYS_LOG_INF("The device is put in USB mass storage mode.\n");
}
```
