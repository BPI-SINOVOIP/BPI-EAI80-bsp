## prj.conf
```kconfig
CONFIG_STDOUT_CONSOLE=y
CONFIG_SYS_LOG=y
CONFIG_SYS_LOG_DEFAULT_LEVEL=1

#USB related configs
CONFIG_USB=y
CONFIG_USB_DEVICE_STACK=y
CONFIG_USB_DEVICE_PRODUCT="uGelis testusb sample"
CONFIG_SYS_LOG_USB_DRIVER_LEVEL=1
CONFIG_USB_DEVICE_LOOPBACK=y
CONFIG_SYS_LOG_USB_DEVICE_LEVEL=1
```

## src/main.c
```c
/*
 * Copyright (c) 2018 Phytec Messtechnik GmbH
 *
 * SPDX-License-Identifier: Apache-2.0
 */

#include <ugelis.h>
#include <logging/sys_log.h>

void main(void)
{
	SYS_LOG_INF("");
}
```
