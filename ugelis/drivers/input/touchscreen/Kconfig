## ugelis/drivers/input/touchscreen/Kconfig
```kconfig
# Kconfig - camera driver configuration options

#
# Copyright (c) 2014-2015 Wind River Systems, Inc.
#
# SPDX-License-Identifier: Apache-2.0
#

menuconfig TOUCHSCREEN
	bool
	prompt "Touchscreen Drivers"
	default n
	help
	Enable options for touchscreen drivers.


source "drivers/input/touchscreen/Kconfig.gm"

source "drivers/input/touchscreen/core/Kconfig"
source "drivers/input/touchscreen/ft5426/Kconfig"
source "drivers/input/touchscreen/gt911/Kconfig"
source "drivers/input/touchscreen/gt9147/Kconfig"
```

## ugelis/drivers/input/touchscreen/Kconfig.gm
```kconfig
# Kconfig - GM6721X CAMERA configuration
#
# Copyright (c) 2016 Open-RnD Sp. z o.o.
#
# SPDX-License-Identifier: Apache-2.0
#

menuconfig TOUCHSCREEN_DRIVERS
	bool "GM6721X MCU touchscreen driver"
	default n
    select TS_CORE
	help
	  Enable touchscreen driver for GM6721X line of MCUs.
```

## ugelis/drivers/input/touchscreen/core/Kconfig
```kconfig
# Kconfig - MPU6050 Six-Axis Motion Tracking device configuration options

#
# Copyright (c) 2016 Intel Corporation
#
# SPDX-License-Identifier: Apache-2.0
#

config TS_CORE
	bool "Enable TS_CORE"
	depends on TOUCHSCREEN_DRIVERS
	default n
```

## ugelis/drivers/input/touchscreen/ft5426/Kconfig
```kconfig
# Kconfig - MPU6050 Six-Axis Motion Tracking device configuration options

#
# Copyright (c) 2016 Intel Corporation
#
# SPDX-License-Identifier: Apache-2.0
#

menuconfig FT5426
	bool "FOCALTECH FT5426 touch sensor support"
	depends on TOUCHSCREEN_DRIVERS
	default n
	help
	  This is a touchscreen sensor-level driver for the FOCALTECH
	  FT5426 touch sensor with a i2c protocol interface.
```

## ugelis/drivers/input/touchscreen/gt911/Kconfig
```kconfig
# Kconfig - MPU6050 Six-Axis Motion Tracking device configuration options

#
# Copyright (c) 2016 Intel Corporation
#
# SPDX-License-Identifier: Apache-2.0
#

menuconfig GT911
	bool "GOODIX GT911 touch sensor support"
	depends on TOUCHSCREEN_DRIVERS
	default n
	help
	  This is a touchscreen sensor-level driver for the GOODIX
	  GT911 touch sensor with a i2c protocol interface.
```

## ugelis/drivers/input/touchscreen/gt9147/Kconfig
```kconfig
# Kconfig - MPU6050 Six-Axis Motion Tracking device configuration options

#
# Copyright (c) 2016 Intel Corporation
#
# SPDX-License-Identifier: Apache-2.0
#

menuconfig GT9147
	bool "GOODIX GT9147 touch sensor support"
	depends on TOUCHSCREEN_DRIVERS
	default n
	help
	  This is a touchscreen sensor-level driver for the GOODIX
	  GT9147 touch sensor with a i2c protocol interface.
```

## ugelis/drivers/key/Kconfig
```kconfig
# Kconfig - Sdcard configuration options
#
#
# Copyright (c) 2015 Intel Corporation
#
# SPDX-License-Identifier: Apache-2.0
#

#
# key options
#
menuconfig GPIO_KEY
	bool
	prompt "GPIO_KEY Driver Support"
	default n
	help
	  Include support for GPIO_KEY.

config EVENT_BUFF_LENGTH
	int "Value for Key Event Buffer Length"
	depends on GPIO_KEY
	default 20
	help
		config for Key Event Buffer Length
```

## ugelis/drivers/lvd/Kconfig
```kconfig
# Kconfig - LVD configuration options
#
#
# Copyright (c) 2015 Intel Corporation
#
# SPDX-License-Identifier: Apache-2.0
#

#
# Real-Time Clock (LVD) options
#
menuconfig LVD
	bool
    prompt "Lower Voltage Detection"
	help
	  Enable options for Lower Voltage Detection drivers.

if LVD

config LVD_0_NAME
	string "Driver instance name"
	default "LVD_0"
    depends on LVD && !HAS_DTS
	help
	  LVD driver instance name

comment "LVD drivers"

endif # LVD

source "drivers/lvd/Kconfig.gm_lvd"
```

## ugelis/drivers/lvd/Kconfig.gm_lvd
```kconfig
# Kconfig - GM SDK LVD
#
# Copyright (C) 2019 Gree Edgeless Microelectronics.
#
# SPDX-License-Identifier: Apache-2.0
#

menuconfig LVD_GM
	bool
	prompt "GM LVD driver"
	depends on LVD && GM_HAL_LVD
	help
	  Enable support for gm lvd driver.
```

## ugelis/drivers/mmc/Kconfig
```kconfig
# Kconfig - Sdcard configuration options
#
#
# Copyright (c) 2015 Intel Corporation
#
# SPDX-License-Identifier: Apache-2.0
#

#
# Sdcard options
#
menuconfig MMC
	bool
	prompt "MMC Support"
	default n
	help
	  Include support for mmc.

if MMC
	source "drivers/mmc/Kconfig.gm"
endif
```

## ugelis/drivers/mmc/Kconfig.gm
```kconfig
# Kconfig - Gree MMC configuration
#
# Copyright (c) 2018 Open-RnD Sp. z o.o.
#
# SPDX-License-Identifier: Apache-2.0
#

config MMC_GM
	bool "MMC Driver for Gree family of MCUs"
	default n
	help
	  Enable MMC driver for Gree line of MCUs
```

## ugelis/drivers/pdm/Kconfig
```kconfig
# Kconfig - CAN configuration options

#
# Copyright (c) 2018 Alexander Wachter
#
# SPDX-License-Identifier: Apache-2.0
#

#
# PDM options
#
menuconfig PDM
	bool
	prompt "PDM Support"
	default n
	help
	  Include support for pdm.

if PDM
	source "drivers/pdm/Kconfig.gm"
endif
```

## ugelis/drivers/pdm/Kconfig.gm
```kconfig
# Kconfig.stm32 - STM32 PDM configuration options

#
# Copyright (c) 2018 Alexander Wachter
#
# SPDX-License-Identifier: Apache-2.0
#

config PDM_GM
	bool "PDM Driver for Gree family of MCUs"
	default n
	help
	  Enable PDM driver for Gree line of MCUs 

config PDM_GM_A
	bool "Enable PDM_A HARDWARE"
	depends on PDM_GM
	default n
	
config PDM_GM_B
	bool "Enable PDM_B HARDWARE"
	depends on PDM_GM
	default n
	
config PDMA
	bool "Enable PDM_A pinmux"
	depends on PDM_GM_A
	default n
	
config PDMB
	bool "Enable PDM_B pinmux"
	depends on PDM_GM_B
	default n
```

## ugelis/drivers/pinmux/Kconfig.gm
```kconfig
# Kconfig - GM6XXXpresso SDK pinmux
#
# Copyright (c) 2016, Freescale Semiconductor, Inc.
#
# SPDX-License-Identifier: Apache-2.0
#

menuconfig PINMUX_GM
	bool "GREE pinmux driver"
	default n
	help
	  Enable the GREE pinmux driver.

if PINMUX_GM

config PINMUX_GM_PORTA
	bool "Port A"
	default n
	help
	  Enable Port A.

config PINMUX_GM_PORTA_NAME
	string "Pinmux Port A driver name"
	depends on PINMUX_GM_PORTA
	default "porta"

config PINMUX_GM_PORTB
	bool "Port B"
	default n
	help
	  Enable Port B.

config PINMUX_GM_PORTB_NAME
	string "Pinmux Port B driver name"
	depends on PINMUX_GM_PORTB
	default "portb"

config PINMUX_GM_PORTC
	bool "Port C"
	default n
	help
	  Enable Port C.

config PINMUX_GM_PORTC_NAME
	string "Pinmux Port C driver name"
	depends on PINMUX_GM_PORTC
	default "portc"

config PINMUX_GM_PORTD
	bool "Port D"
	default n
	help
	  Enable Port D.

config PINMUX_GM_PORTD_NAME
	string "Pinmux Port D driver name"
	depends on PINMUX_GM_PORTD
	default "portd"

config PINMUX_GM_PORTE
	bool "Port E"
	default n
	help
	  Enable Port E.

config PINMUX_GM_PORTE_NAME
	string "Pinmux Port E driver name"
	depends on PINMUX_GM_PORTE
	default "porte"
 
config PINMUX_GM_PORTF
	bool "Port F"
	default n
	help
	  Enable Port F.

config PINMUX_GM_PORTF_NAME
	string "Pinmux Port F driver name"
	depends on PINMUX_GM_PORTF
	default "portf"
    
config PINMUX_GM_PORTG
	bool "Port G"
	default n
	help
	  Enable Port G.

config PINMUX_GM_PORTG_NAME
	string "Pinmux Port G driver name"
	depends on PINMUX_GM_PORTG
	default "portg"

config PINMUX_GM_PORTH
	bool "Port H"
	default n
	help
	  Enable Port H.

config PINMUX_GM_PORTH_NAME
	string "Pinmux Port H driver name"
	depends on PINMUX_GM_PORTH
	default "porth"

config PINMUX_GM_PORTI
	bool "Port I"
	default n
	help
	  Enable Port I.

config PINMUX_GM_PORTI_NAME
	string "Pinmux Port I driver name"
	depends on PINMUX_GM_PORTI
	default "porti"

config PINMUX_GM_PORTJ
	bool "Port J"
	default n
	help
	  Enable Port J.

config PINMUX_GM_PORTJ_NAME
	string "Pinmux Port J driver name"
	depends on PINMUX_GM_PORTJ
	default "portj"

config PINMUX_GM_PORTK
	bool "Port K"
	default n
	help
	  Enable Port K.

config PINMUX_GM_PORTK_NAME
	string "Pinmux Port K driver name"
	depends on PINMUX_GM_PORTK
	default "portk"    

endif # PINMUX_GM
```

## ugelis/drivers/pm/Kconfig
```kconfig
# Kconfig - power configuration options
#
#
# Copyright (c) 2015 Intel Corporation
#
# SPDX-License-Identifier: Apache-2.0
#

#
# power options
#
menuconfig PM
	bool
	prompt "Power Framework Support"
	default y
    select DEVICE_POWER_MANAGEMENT
	help
	  Include support for power.


if PM
	source "drivers/pm/Kconfig.gm"

config PM_DEBUG
	bool "Debug For PM"
	default n
	help
	  Enable Debug For PM
endif
```

## ugelis/drivers/pm/Kconfig.gm
```kconfig
# Kconfig - Gree POWER configuration
#
# Copyright (c) 2018 Open-RnD Sp. z o.o.
#
# SPDX-License-Identifier: Apache-2.0
#

config POWER_GM
	bool "POWER Driver for Gree MCU"
	default n
	select RTC
    select RTC_GM
    select GM_HAL_RTC
	help
	  Enable POWER driver for Gree line of MCUs
```

## ugelis/drivers/pm/pm_boot1/pm_boot1/ulibs/hal/gree/Kconfig
```kconfig
# Kconfig - GM HAL config

# Copyright (c) 2016 Linaro Limited.
#
# SPDX-License-Identifier: Apache-2.0


config HAS_GM_HAL
	bool
	select HAS_CMSIS
	default n

if HAS_GM_HAL
config  USE_HAL_TEST
    bool "enable using hal code to test"
    default n
    help
    enable using hal code to test

config  USE_DEVICE_LL_DIRECT
    bool "Enable user to use the files about regist level directly"
    default n
    help
    Link with local GM hal SDK driverlib sources.

config GM_HAL_BUILTIN
	bool "Enable building the GM HAL SDK files stored in the uGelis tree"
    default y
    help
    Link with local GM hal SDK driverlib sources.
endif

   gsource "ext/hal/gree/Kconfig.gm*"
```

## ugelis/drivers/rtc/Kconfig
```kconfig
# Kconfig - RTC configuration options
#
#
# Copyright (c) 2015 Intel Corporation
#
# SPDX-License-Identifier: Apache-2.0
#

#
# Real-Time Clock (RTC) options
#
menuconfig RTC
	bool
    prompt "Real-Time Clock"
	help
	  Enable options for Real-Time Clock drivers.

if RTC

config RTC_0_NAME
	string "Driver instance name"
	default "RTC_0"
    depends on RTC && !HAS_DTS
	help
	  RTC driver instance name

comment "RTC drivers"

endif # RTC

source "drivers/rtc/Kconfig.mcux_rtc"
source "drivers/rtc/Kconfig.gm_rtc"
```

## ugelis/drivers/rtc/Kconfig.gm_rtc
```kconfig
# Kconfig - GM SDK RTC
#
# Copyright (C) 2019 Gree Edgeless Microelectronics.
#
# SPDX-License-Identifier: Apache-2.0
#

menuconfig RTC_GM
	bool
	prompt "GM RTC driver"
	depends on RTC && GM_HAL_RTC
	help
	  Enable support for gm rtc driver.
```

## ugelis/drivers/serial/Kconfig.gm
```kconfig
config UART_GM
	bool "Gree UART driver"
	default y
	select SERIAL_HAS_DRIVER
	select SERIAL_SUPPORT_INTERRUPT
	depends on SOC_FAMILY_GM
	help
       This option enables the Gree UART driver

       
```

## ugelis/drivers/tim/Kconfig.bak
```kconfig
# Kconfig - TIM configuration options

#
# Copyright (c) 2015 Intel Corporation
#
# SPDX-License-Identifier: Apache-2.0
#

menuconfig TIM
	bool "TIM Drivers"
	help
	  Enable config options for TIM drivers.

if TIM

config SYS_LOG_TIM_LEVEL
	int "TIM Driver Log level"
	depends on SYS_LOG
	default 0
	range 0 4
	help
	  Sets log level for TIM drivers.
	  Levels are:
	  - 0 OFF, do not write
	  - 1 ERROR, only write SYS_LOG_ERR
	  - 2 WARNING, write SYS_LOG_WRN in addition to previous level
	  - 3 INFO, write SYS_LOG_INF in addition to previous levels
	  - 4 DEBUG, write SYS_LOG_DBG in addition to previous levels
	  
config TIM_INIT_PRIORITY
    int 
    default 11
    prompt "Init priority"
    help 
        TIM Device driver initialization priority
        
config TIM_1
    bool "Enable TIM 1"
    
config TIM_1_NAME
    string "TIM 1 Driver's name"
    depends on TIM_1
    default "TIM_1"
    
config TIM_1_IRQ_PRI
    int
    depends on TIM_1
    prompt "TIM 1 interrupt priority"
    default 2
    
config TIM_2
    bool "Enable TIM 2"
    
config TIM_2_NAME
    string "TIM 2 Driver's name"
    depends on TIM_2
    default "TIM_2"
    
config TIM_2_IRQ_PRI
    int
    depends on TIM_2
    prompt "TIM 2 interrupt priority"
    default 2    
    
config TIM_3
    bool "Enable TIM 3"
    
config TIM_3_NAME
    string "TIM 3 Driver's name"
    depends on TIM_3
    default "TIM_3"
    
config TIM_3_IRQ_PRI
    int
    depends on TIM_3
    prompt "TIM 3 interrupt priority"
    default 2
    
config TIM_4
    bool "Enable TIM 4"
    
config TIM_4_NAME
    string "TIM 4 Driver's name"
    depends on TIM_4
    default "TIM_4"
    
config TIM_4_IRQ_PRI
    int
    depends on TIM_4
    prompt "TIM 4 interrupt priority"
    default 2 
    
config TIM_5
    bool "Enable TIM 5"
    
config TIM_5_NAME
    string "TIM 5 Driver's name"
    depends on TIM_5
    default "TIM_5"
    
config TIM_5_IRQ_PRI
    int
    depends on TIM_5
    prompt "TIM 5 interrupt priority"
    default 2
    
config TIM_8
    bool "Enable TIM 8"
    
config TIM_8_NAME
    string "TIM 8 Driver's name"
    depends on TIM_8
    default "TIM_8"
    
config TIM_8_IRQ_PRI
    int
    depends on TIM_8
    prompt "TIM 8 interrupt priority"
    default 2 
    
config TIM_9
    bool "Enable TIM 9"
    
config TIM_9_NAME
    string "TIM 9 Driver's name"
    depends on TIM_9
    default "TIM_9"
    
config TIM_9_IRQ_PRI
    int
    depends on TIM_9
    prompt "TIM 9 interrupt priority"
    default 2 
    
config TIM_10
    bool "Enable TIM 10"
    
config TIM_10_NAME
    string "TIM 10 Driver's name"
    depends on TIM_10
    default "TIM_10"
    
config TIM_10_IRQ_PRI
    int
    depends on TIM_10
    prompt "TIM 10 interrupt priority"
    default 2 
    
config TIM_11
    bool "Enable TIM 11"
    
config TIM_11_NAME
    string "TIM 11 Driver's name"
    depends on TIM_11
    default "TIM_11"
    
config TIM_11_IRQ_PRI
    int
    depends on TIM_11
    prompt "TIM 11 interrupt priority"
    default 2 
    
config TIM_12
    bool "Enable TIM 12"
    
config TIM_12_NAME
    string "TIM 12 Driver's name"
    depends on TIM_12
    default "TIM_12"
    
config TIM_12_IRQ_PRI
    int
    depends on TIM_12
    prompt "TIM 12 interrupt priority"
    default 2 
    
config TIM_13
    bool "Enable TIM 13"
    
config TIM_13_NAME
    string "TIM 13 Driver's name"
    depends on TIM_13
    default "TIM_13"
    
config TIM_13_IRQ_PRI
    int
    depends on TIM_13
    prompt "TIM 13 interrupt priority"
    default 2  
    
config TIM_14
    bool "Enable TIM 14"
    
config TIM_14_NAME
    string "TIM 14 Driver's name"
    depends on TIM_14
    default "TIM_14"
    
config TIM_14_IRQ_PRI
    int
    depends on TIM_14
    prompt "TIM 14 interrupt priority"
    default 2            

source "drivers/tim/Kconfig.gm"

endif # TIM
```
