## ugelis/drivers/tim/Kconfig.gm
```kconfig
# Kconfig.gm - GREE TIM configuration options
#

menuconfig TIM_GM
	bool "GREE GM TIM driver"
	depends on TIM && GM_HAL_TIM
	default n
	help
	  Enable the TIM driver on GREE GM6xxx boards.	  

#if TIM_GM
	  
config TIM_GM_1
	bool "TIM block 1"
	depends on TIM_GM
	default n
	help
	  Enable support for gm tim1 driver.
	  
config TIM_GM_1_NAME
    string "Driver name"
	depends on TIM_GM_1
	default "TIM1"
	
config TIM_GM_1_IRQ_PRI
    int "TIM 1 interrupt priority"
	depends on TIM_GM_1
	range 0 5
	default 1
	help
	    GM6XXX TIM 1 IRQ priority.

config TIM_GM_2
	bool "TIM block 2"
	depends on TIM_GM
	default n
	help
	  Enable support for gm tim2 driver.
	  
config TIM_GM_2_NAME
    string "Driver name"
	depends on TIM_GM_2
	default "TIM2"
	
config TIM_GM_2_IRQ_PRI
    int "TIM 2 interrupt priority"
	depends on TIM_GM_2
	range 0 5
	default 1
	help
	    GM6XXX TIM 2 IRQ priority.
		
config TIM_GM_3
	bool "TIM block 3"
	depends on TIM_GM
	default n
	help
	  Enable support for gm tim3 driver.
	  
config TIM_GM_3_NAME
    string "Driver name"
	depends on TIM_GM_3
	default "TIM3"
	
config TIM_GM_3_IRQ_PRI
    int "TIM 3 interrupt priority"
	depends on TIM_GM_3
	range 0 5
	default 1
	help
	    GM6XXX TIM 3 IRQ priority.

config TIM_GM_4
	bool "TIM block 4"
	depends on TIM_GM
	default n
	help
	  Enable support for gm tim4 driver.
	  
config TIM_GM_4_NAME
    string "Driver name"
	depends on TIM_GM_4
	default "TIM4"
	
config TIM_GM_4_IRQ_PRI
    int "TIM 4 interrupt priority"
	depends on TIM_GM_4
	range 0 5
	default 1
	help
	    GM6XXX TIM 4 IRQ priority.		
		
config TIM_GM_5
	bool "TIM block 5"
	depends on TIM_GM
	default n
	help
	  Enable support for gm tim5 driver.
	  
config TIM_GM_5_NAME
    string "Driver name"
	depends on TIM_GM_5
	default "TIM5"
	
config TIM_GM_5_IRQ_PRI
    int "TIM 5 interrupt priority"
	depends on TIM_GM_5
	range 0 5
	default 1
	help
	    GM6XXX TIM 5 IRQ priority.

config TIM_GM_8
	bool "TIM block 8"
	depends on TIM_GM
	default n
	help
	  Enable support for gm tim8 driver.
	  
config TIM_GM_8_NAME
    string "Driver name"
	depends on TIM_GM_8
	default "TIM8"
	
config TIM_GM_8_IRQ_PRI
    int "TIM 8 interrupt priority"
	depends on TIM_GM_8
	range 0 5
	default 1
	help
	    GM6XXX TIM 8 IRQ priority.
		
config TIM_GM_9
	bool "TIM block 9"
	depends on TIM_GM
	default n
	help
	  Enable support for gm tim9 driver.
	  
config TIM_GM_9_NAME
    string "Driver name"
	depends on TIM_GM_9
	default "TIM9"
	
config TIM_GM_9_IRQ_PRI
    int "TIM 9 interrupt priority"
	depends on TIM_GM_9
	range 0 5
	default 1
	help
	    GM6XXX TIM 9 IRQ priority.

config TIM_GM_10
	bool "TIM block 10"
	depends on TIM_GM
	default n
	help
	  Enable support for gm tim10 driver.
	  
config TIM_GM_10_NAME
    string "Driver name"
	depends on TIM_GM_10
	default "TIM10"
	
config TIM_GM_10_IRQ_PRI
    int "TIM 10 interrupt priority"
	depends on TIM_GM_10
	range 0 5
	default 1
	help
	    GM6XXX TIM 10 IRQ priority.		
		
config TIM_GM_11
	bool "TIM block 11"
	depends on TIM_GM
	default n
	help
	  Enable support for gm tim11 driver.
	  
config TIM_GM_11_NAME
    string "Driver name"
	depends on TIM_GM_11
	default "TIM11"
	
config TIM_GM_11_IRQ_PRI
    int "TIM 11 interrupt priority"
	depends on TIM_GM_11
	range 0 5
	default 1
	help
	    GM6XXX TIM 11 IRQ priority.

config TIM_GM_12
	bool "TIM block 12"
	depends on TIM_GM
	default n
	help
	  Enable support for gm tim12 driver.
	  
config TIM_GM_12_NAME
    string "Driver name"
	depends on TIM_GM_12
	default "TIM12"
	
config TIM_GM_12_IRQ_PRI
    int "TIM 12 interrupt priority"
	depends on TIM_GM_12
	range 0 5
	default 1
	help
	    GM6XXX TIM 12 IRQ priority.
		
config TIM_GM_13
	bool "TIM block 13"
	depends on TIM_GM
	default n
	help
	  Enable support for gm tim13 driver.
	  
config TIM_GM_13_NAME
    string "Driver name"
	depends on TIM_GM_13
	default "TIM13"
	
config TIM_GM_13_IRQ_PRI
    int "TIM 13 interrupt priority"
	depends on TIM_GM_13
	range 0 5
	default 1
	help
	    GM6XXX TIM 13 IRQ priority.

config TIM_GM_14
	bool "TIM block 14"
	depends on TIM_GM
	default n
	help
	  Enable support for gm tim14 driver.
	  
config TIM_GM_14_NAME
    string "Driver name"
	depends on TIM_GM_14
	default "TIM14"
	
config TIM_GM_14_IRQ_PRI
    int "TIM 14 interrupt priority"
	depends on TIM_GM_14
	range 0 5
	default 1
	help
	    GM6XXX TIM 14 IRQ priority.		
				
#endif   #TIM_GM	


	
```

## ugelis/drivers/watchdog/Kconfig.gm
```kconfig
# Kconfig - STM32 IWDG configuration
#
# Copyright (c) 2016 Open-RnD Sp. z o.o.
#
# SPDX-License-Identifier: Apache-2.0
#

if SOC_FAMILY_GM

config IWDG_GM
	bool "Independent Watchdog (IWDG) Driver for GM family of MCUs"
	help
	  Enable IWDG driver for GM line of MCUs
config IWDG_GM_PRESCALER
	int "Prescaler divider for clock feeding the IWDG"
	depends on IWDG_GM
	default 64
	range 4 256
	help
	  Set the prescaler divider for the clock feeding the Independent
	  Watchdog. Higher values indicate that the watchdog will need to
	  be reloaded more frequently. Allowed values: 4, 8, 16, 32, 64,
	  128, 256. This setting combined with reload counter defines the
	  watchdog countdown time.

config IWDG_GM_RELOAD_COUNTER
	int "Value for IWDG counter"
	depends on IWDG_GM
	default 500
	range 0 4095
	help
	  Configure the value to be loaded into the watchdog's counter each
	  time a reload operation is performed. This value combined with
	  prescaler setting defines the watchdog countdown time.

config IWDG_GM_START_AT_BOOT
	bool "Start IWDG during boot"
	depends on IWDG_GM
	default n
	help
	  Enable this setting to allow IWDG to be automatically started
	  during device initialization. Note that once IWDG is started
	  it must be reloaded before the counter reaches 0, otherwise
	  the MCU will be reset.

config IWDG_GM_DEVICE_NAME
	string "Device name for Independent Watchdog (IWDG)"
	depends on IWDG_GM
	default "IWDG"
	help
	  Set the name used by IWDG device during registration.

config WWDG_GM
	bool "Window Watchdog (WWDG) Driver for GM family of MCUs"
	help
	  Enable WWDG driver for GM line of MCUs

config WWDG_GM_DIV_FACTOR
	int "Select wwdg clk division factor"
	depends on WWDG_GM
	default 24
	range 0 511
	help
	  Set the prescaler divider for the clock Watchdog. Allowed values: 
	  0:511. This setting combined with reload counter defines the 
	  watchdog countdown time.
	
config WWDG_GM_MODE
	int "Set wwdg work mode"
	depends on WWDG_GM
	default 0
	range 0 3
	help
	  Configure the wwdg clk src, 0-normal ,1-WIN ,2-NORMAL_EWI ,3-WIN_EWI

config WWDG_GM_RELOAD_COUNTER
	int "Value for WWDG counter"
	depends on WWDG_GM
	default 5000
	range 0 10000
	help
	  Configure the value to be loaded into the watchdog's counter each
	  time a reload operation is performed. This value combined with
	  prescaler setting defines the watchdog countdown time.

config WWDG_GM_WINDOW_VALUE
	int "Window value for WWDG counter"
	depends on WWDG_GM
	default 3000
	range 64 4500
	help
	  Configure the window value to be compare to the downcounter 

config WWDG_GM_WINLEN
	int "WWDG decrease counter after it was generated by watchdog interrupt"
	depends on WWDG_GM
	default 15
	range 0 15
	help
	  Set the winlen in the EWI mode. Higher values indicate that the watchdog decreased counter was more bigger when it was generated by watchdog interrupt. Allowed values: 0~15. (watchdog decreased counter = 0x40*winlen).

config WWDG_GM_DEVICE_NAME
	string "Device name for Window Watchdog (WWDG)"
	depends on WWDG_GM
	default "WWDG"
	help
	  Set the name used by WWDG device during registration.
endif # SOC_FAMILY_GM
```

## ugelis/dts/bindings/bluetooth/ugelis,bt-hci-spi.yaml
```yaml
#
# Copyright (c) 2018, I-SENSE group of ICCS
#
# SPDX-License-Identifier: Apache-2.0
#
---
title: Bluetooth module based on uGelis's Bluetooth HCI SPI driver
id: ugelis,bt-hci-spi
version: 0.1

description: >
    This binding gives the base representation of a bluetooth module which use
    uGelis's bluetooth Host Controller Interface SPI driver (e.g. nRF51822).

inherits:
    !include spi-device.yaml

properties:
    compatible:
      constraint: "ugelis,bt-hci-spi"

    irq-gpios:
      type: compound
      category: required
      generation: define, use-prop-name

    reset-gpios:
      type: compound
      category: required
      generation: define, use-prop-name

...
```

## ugelis/dts/bindings/can/gree,gm-can.yaml
```yaml
---
title: GREE CAN
id: gree,gm-can
version: 0.1

description: >
    This binding gives a base representation of the GREE CAN

inherits:
    !include can.yaml

properties:
    compatible:
      type: string
      category: required
      description: compatible strings
      constraint: "gree,gm-can"

    reg:
      type: array
      description: mmio register space
      generation: define
      category: required

    interrupts:
      type: array
      category: required
      description: required interrupts
      generation: define
      
    workmode:
      type: int
      category: required
      description: can work mode
      generation: define
      
    baudrate:
      type: int
      category: required
      description: can work baudrate
      generation: define
    
    errWarnThreshold:
      type: int
      category: required
      description: can erroe and waring threshold
      generation: define
      
    sample:
      type: int
      category: required
      description: can sample times
      generation: define
      
    sjw:
      type: int
      category: required
      description: can tq clock cycle
      generation: define      
      
    bs1:
      type: int
      category: required
      description: can segment point
      generation: define
      
    bs2:
      type: int
      category: required
      description: can segment point
      generation: define

...
```
