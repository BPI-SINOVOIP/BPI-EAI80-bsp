## ugelis/drivers/gpio/Kconfig.gm
```kconfig
# Kconfig.gm- GREE GPIO configuration options
#

menuconfig GPIO_GM
	bool "GREE GM GPIO driver"
	depends on GPIO
	default n
	help
	  Enable the GPIO driver on GREE GM6xxx boards

if GPIO_GM

config GPIO_GM_A
	bool "GPIO block A"
	depends on GPIO_GM
	default n
	help
	  Include support for the GPIO port A.

config GPIO_GM_A_NAME
	string "Driver name"
	depends on GPIO_GM_A
	default "GPIOA"

config GPIO_GM_A_IRQ_PRI
	int "GPIO A interrupt priority"
	depends on GPIO_GM_A
	range 0 5
	default 1
	help
	  GM6XXX GPIO A IRQ priority.

config GPIO_GM_B
	bool "GPIO block B"
	depends on GPIO_GM
	default n
	help
	  Include support for the GPIO port B.

config GPIO_GM_B_NAME
	string "Driver name"
	depends on GPIO_GM_B
	default "GPIOB"

config GPIO_GM_B_IRQ_PRI
	int "GPIO B interrupt priority"
	depends on GPIO_GM_B
	range 0 5
	default 1
	help
	  GM6XXX GPIO B IRQ priority.

config GPIO_GM_C
	bool "GPIO block C"
	depends on GPIO_GM
	default n
	help
	  Include support for the GPIO port C.

config GPIO_GM_C_NAME
	string "Driver name"
	depends on GPIO_GM_C
	default "GPIOC"

config GPIO_GM_C_IRQ_PRI
	int "GPIO C interrupt priority"
	depends on GPIO_GM_C
	range 0 5
	default 1
	help
	  GM6XXX GPIO C IRQ priority.

config GPIO_GM_D
	bool "GPIO block D"
	depends on GPIO_GM
	default n
	help
	  Include support for the GPIO port D.

config GPIO_GM_D_NAME
	string "Driver name"
	depends on GPIO_GM_D
	default "GPIOD"

config GPIO_GM_D_IRQ_PRI
	int "GPIO D interrupt priority"
	depends on GPIO_GM_D
	range 0 5
	default 1
	help
	  GM6XXX GPIO D IRQ priority.
	  
config GPIO_GM_E
	bool "GPIO block E"
	depends on GPIO_GM
	default n
	help
	  Include support for the GPIO port E.

config GPIO_GM_E_NAME
	string "Driver name"
	depends on GPIO_GM_E
	default "GPIOE"

config GPIO_GM_E_IRQ_PRI
	int "GPIO E interrupt priority"
	depends on GPIO_GM_E
	range 0 5
	default 1
	help
	  GM6XXX GPIO E IRQ priority.

config GPIO_GM_F
	bool "GPIO block F"
	depends on GPIO_GM
	default n
	help
	  Include support for the GPIO port F.

config GPIO_GM_F_NAME
	string "Driver name"
	depends on GPIO_GM_F
	default "GPIOF"

config GPIO_GM_F_IRQ_PRI
	int "GPIO F interrupt priority"
	depends on GPIO_GM_F
	range 0 5
	default 1
	help
	  GM GPIO F IRQ priority.

config GPIO_GM_G
	bool "GPIO block G"
	depends on GPIO_GM
	default n
	help
	  Include support for the GPIO port G.

config GPIO_GM_G_NAME
	string "Driver name"
	depends on GPIO_GM_G
	default "GPIOG"

config GPIO_GM_G_IRQ_PRI
	int "GPIO F interrupt priority"
	depends on GPIO_GM_G
	range 0 5
	default 1
	help
	  GM GPIO G IRQ priority.  

config GPIO_GM_H
	bool "GPIO block H"
	depends on GPIO_GM
	default n
	help
	  Include support for the GPIO port H.

config GPIO_GM_H_NAME
	string "Driver name"
	depends on GPIO_GM_H
	default "GPIOH"

config GPIO_GM_H_IRQ_PRI
	int "GPIO H interrupt priority"
	depends on GPIO_GM_H
	range 0 5
	default 1
	help
	  GM GPIO H IRQ priority

config GPIO_GM_I
	bool "GPIO block I"
	depends on GPIO_GM
	default n
	help
	  Include support for the GPIO port I.

config GPIO_GM_I_NAME
	string "Driver name"
	depends on GPIO_GM_I
	default "GPIOI"

config GPIO_GM_I_IRQ_PRI
	int "GPIO I interrupt priority"
	depends on GPIO_GM_I
	range 0 5
	default 1
	help
	  GM GPIO I IRQ priority

config GPIO_GM_J
	bool "GPIO block J"
	depends on GPIO_GM
	default n
	help
	  Include support for the GPIO port J.

config GPIO_GM_J_NAME
	string "Driver name"
	depends on GPIO_GM_J
	default "GPIOJ"

config GPIO_GM_J_IRQ_PRI
	int "GPIO F interrupt priority"
	depends on GPIO_GM_J
	range 0 5
	default 1
	help
	  GM GPIO J IRQ priority
      
config GPIO_GM_K
	bool "GPIO block K"
	depends on GPIO_GM
	default n
	help
	  Include support for the GPIO port K.

config GPIO_GM_K_NAME
	string "Driver name"
	depends on GPIO_GM_K
	default "GPIOK"

config GPIO_GM_K_IRQ_PRI
	int "GPIO K interrupt priority"
	depends on GPIO_GM_K
	range 0 5
	default 1
	help
	  GM GPIO K IRQ priority
   
endif # GPIO_GM
```

## ugelis/drivers/i2c/Kconfig.gm
```kconfig
#
# Copyright (c) 2017 Linaro Ltd.
#
# SPDX-License-Identifier: Apache-2.0
#

config I2C_GM
	bool "GM I2C support"
	depends on I2C
    select I2C_INTERRUPT_DRIVEN
	help
	  Enable hardware GM I2C

config I2C_INTERRUPT_DRIVEN
	bool "GM I2C interrupt"
	depends on I2C_GM
	help
	  select I2C interrupt driven
      
# ---------- Port 0 ----------

config I2C_GM_0
	bool "Enable GM I2C device 0"
	depends on I2C_GM
    select I2C0
	help
	  This tells the driver to configure the I2C device at boot, depending
	  on the additional configuration options below.

config I2C_GM_0_NAME
	string "hardware GM I2C device 0 device name"
	default "I2C_0"
	depends on I2C_GM_0
	help
	  This is the device name for the I2C device, and is included in the
	  device struct.

# ---------- Port 1 ----------

config I2C_GM_1
	bool "Enable GM I2C device 1"
	depends on I2C_GM
    select I2C1
	help
	  This tells the driver to configure the I2C device at boot, depending
	  on the additional configuration options below.

config I2C_GM_1_NAME
	string "hardware GM I2C device 1 device name"
	default "I2C_1"
	depends on I2C_GM_1
	help
	  This is the device name for the I2C device, and is included in the
	  device struct.

# ---------- Port 2 ----------

config I2C_GM_2
	bool "Enable GM I2C device 2"
	depends on I2C_GM
    select I2C2
	help
	  This tells the driver to configure the I2C device at boot, depending
	  on the additional configuration options below.

config I2C_GM_2_NAME
	string "hardware GM I2C device 2 device name"
	default "I2C_2"
	depends on I2C_GM_2
	help
	  This is the device name for the I2C device, and is included in the
	  device struct.
```

## ugelis/drivers/i2s/Kconfig.gm
```kconfig
# Kconfig - Gree SAI configuration
#
# Copyright (c) 2018 Open-RnD Sp. z o.o.
#
# SPDX-License-Identifier: Apache-2.0
#

config SAI_GM
	bool "SAI Driver for Gree family of MCUs"
	default n
	help
	  Enable SAI driver for Gree line of MCUs
	
config SAI_GM_A
	bool "Enable SAI_A HARDWARE"
	depends on SAI_GM
	default n
	
config SAI_GM_B
	bool "Enable SAI_B HARDWARE"
	depends on SAI_GM
	default n
	
config SAIA
	bool "Enable SAI_A pinmux"
	depends on SAI_GM_A
	default n
	
config SAIB
	bool "Enable SAI_B pinmux"
	depends on SAI_GM_B
	default n
```

## ugelis/drivers/input/Kconfig
```kconfig
# Kconfig - camera driver configuration options

#
# Copyright (c) 2014-2015 Wind River Systems, Inc.
#
# SPDX-License-Identifier: Apache-2.0
#

menuconfig INPUT
	bool
	prompt "Input Drivers"
	default n
	help
	Enable options for input drivers.

source "drivers/input/Kconfig.gm"


source "drivers/input/touchscreen/Kconfig"
```

## ugelis/drivers/input/Kconfig.gm
```kconfig
# Kconfig - GM6721X CAMERA configuration
#
# Copyright (c) 2016 Open-RnD Sp. z o.o.
#
# SPDX-License-Identifier: Apache-2.0
#

menuconfig INPUT_DRIVERS
	bool "GM6721X MCU input driver"
	default n
	depends on INPUT
	help
	  Enable input driver for GM6721X line of MCUs.
```
