## ugelis/drivers/adc/Kconfig.gm
```kconfig
# Kconfig - ADC configuration options

#
# Copyright (c) 2015 Intel Corporation
#
# SPDX-License-Identifier: Apache-2.0
#




menuconfig ADC_GM
	bool
    prompt   "ADC Gree Driver"
	default y
	select ADC_0
	help
	  Enable the driver implementation of the Designware ADC IP.

if ADC_GM


config ADC_GM_CALIBRATION
	bool 
    prompt "Enable Calibration"
	default y
	help
	  Enables ADC to run with a calibrated output at the
	  expense of execution speed when exiting low power states.
	  If disabled, the ADC will require the application/system-integrator
	  to provide a calibration method.

config ADC_GM_DUMMY_CONVERSION
	bool 
    prompt "Enable dummy conversion"
	default y
	help
	  After awaking from low power state a dummy
	  conversion must be performed and discarded.
	  If disabled the user will have to discard the first
	  sample after a resume from a low power state.

choice
	prompt "Output Mode"
	default ADC_GM_SERIAL
	help
	  ADC output mode: parallel or serial.

config ADC_GM_SERIAL
	bool "Serial"

config ADC_GM_PARALLEL
	bool "Parallel"

endchoice

choice
	prompt "Sequence Mode"
	default ADC_GM_SINGLESHOT
	help
	  ADC sequence mode - single run/repetitive

config ADC_GM_SINGLESHOT
	bool "Single Ended"

config ADC_GM_REPETITIVE
	bool "Differential"

endchoice

choice
	prompt "Capture Mode"
	default ADC_GM_RISING_EDGE
	help
	  ADC controller capture mode:
	  by rising or falling edge of adc_clk

config ADC_GM_RISING_EDGE
	bool "Rising Edge"

config ADC_GM_FALLING_EDGE
	bool "Falling Edge"

endchoice

config ADC_GM_SAMPLE_WIDTH
	int "Sample Width"
	default 31
	help
	  Defines ADC device data sample width (resolution):

	  - 0 = 6 bits resolution

	  - 1 = 8 bits resolution

	  - 2 = 10 bits resolution

	  - 3 = 12 bits resolution

config ADC_GM_SERIAL_DELAY
	int "Serial Delay"
	default 1
	help
	  Number of ADC clock ticks that the first bit of
	  the serial output is delayed after the conversion
	  has started.

config ADC_GM_CLOCK_RATIO
	int "Clock Ratio"
	default 1024
	help
	  ADC Clock Ratio

endif # ADC_GM
```

## ugelis/drivers/camera/Kconfig
```kconfig
# Kconfig - camera driver configuration options

#
# Copyright (c) 2014-2015 Wind River Systems, Inc.
#
# SPDX-License-Identifier: Apache-2.0
#

menuconfig CAMERA
	bool
	prompt "Camera Drivers"
	default n
	help
	Enable options for camera drivers.

if CAMERA

config CAMERA_HAS_DRIVER
	bool
	default n
	help
	This is an option to be enabled by individual camera driver
	to signal that there is a camera driver. This is being used
	by other drivers which are dependent on camera.

comment "Camera interface Drivers"

source "drivers/camera/Kconfig.gm"

comment "Camera sensor devices"

source "drivers/camera/ov5640/Kconfig"
source "drivers/camera/ov7725/Kconfig"
source "drivers/camera/gc0308/Kconfig"
source "drivers/camera/bf3007/Kconfig"
source "drivers/camera/gc2145/Kconfig"
source "drivers/camera/sccb/Kconfig"
endif
```

## ugelis/drivers/camera/Kconfig.gm
```kconfig
# Kconfig - GM6721X CAMERA configuration
#
# Copyright (c) 2016 Open-RnD Sp. z o.o.
#
# SPDX-License-Identifier: Apache-2.0
#

menuconfig CAMERA_GM6721X
	bool "GM6721X MCU camera driver"
	default n
	select CAMERA_HAS_DRIVER
	depends on SOC_SERIES_GM6721X
	help
	  Enable camera driver for GM6721X line of MCUs.

config DCMI_0
	bool "Enable DCMI_0 pinmux"
	depends on CAMERA_GM6721X
	default n
    
config DCMI_1
	bool "Enable DCMI_1 pinmux"
	depends on CAMERA_GM6721X
	default n
```

## ugelis/drivers/camera/bf3007/Kconfig
```kconfig
# Kconfig - MPU6050 Six-Axis Motion Tracking device configuration options

#
# Copyright (c) 2016 Intel Corporation
#
# SPDX-License-Identifier: Apache-2.0
#

menuconfig BF3007
	bool "OmniVision BF3007 sensor support"
	depends on CAMERA_HAS_DRIVER
	default n
	help
	  This is a Video4Linux2 sensor-level driver for the Omnivision
	  BF3007 camera sensor with a MIPI CSI-2 interface.

config BF3007_0
	bool "Enable BF3007_0"
	depends on BF3007
    select DCMI_0
	default n

config BF3007_1
	bool "Enable BF3007_1"
	depends on BF3007
    select DCMI_1
	default n
	
config BF3007_MIRROR
	bool "BF3007 get frame by mirror format"
	depends on BF3007
	default n
```

## ugelis/drivers/camera/gc0308/Kconfig
```kconfig
# Kconfig - MPU6050 Six-Axis Motion Tracking device configuration options

#
# Copyright (c) 2016 Intel Corporation
#
# SPDX-License-Identifier: Apache-2.0
#

menuconfig GC0308
	bool "OmniVision GC0308 sensor support"
	depends on CAMERA_HAS_DRIVER
	default n
	help
	  This is a Video4Linux2 sensor-level driver for the Omnivision
	  GC0308 camera sensor with a MIPI CSI-2 interface.

config GC0308_0
	bool "Enable GC0308_0"
	depends on GC0308
    select DCMI_0
	default n

config GC0308_1
	bool "Enable GC0308_1"
	depends on GC0308
    select DCMI_1
	default n
	
config GC0308_MIRROR
	bool "GC0308 get frame by mirror format"
	depends on GC0308
	default n
```

## ugelis/drivers/camera/gc2145/Kconfig
```kconfig
# Kconfig - MPU6050 Six-Axis Motion Tracking device configuration options

#
# Copyright (c) 2016 Intel Corporation
#
# SPDX-License-Identifier: Apache-2.0
#

menuconfig GC2145
	bool "OmniVision GC2145 sensor support"
	depends on CAMERA_HAS_DRIVER
	default n
	help
	  This is a Video4Linux2 sensor-level driver for the Omnivision
	  GC2145 camera sensor with a MIPI CSI-2 interface.

config GC2145_0
	bool "Enable GC2145_0"
	depends on GC2145
    select DCMI_0
	default n

config GC2145_1
	bool "Enable GC2145_1"
	depends on GC2145
    select DCMI_1
	default n
	
config GC2145_MIRROR
	bool "GC2145 get frame by mirror format"
	depends on GC2145
	default n
```

## ugelis/drivers/camera/ov5640/Kconfig
```kconfig
# Kconfig - MPU6050 Six-Axis Motion Tracking device configuration options

#
# Copyright (c) 2016 Intel Corporation
#
# SPDX-License-Identifier: Apache-2.0
#

menuconfig OV5640
	bool "OmniVision OV5640 sensor support"
	depends on CAMERA_HAS_DRIVER
	default n
	help
	  This is a Video4Linux2 sensor-level driver for the Omnivision
	  OV5640 camera sensor with a MIPI CSI-2 interface.

config OV5640_0
	bool "Enable OV5640_0"
	depends on OV5640
    select DCMI_0
	default n

config OV5640_1
	bool "Enable OV5640_1"
	depends on OV5640
    select DCMI_1
	default n
	
config OV5640_MIRROR
	bool "OV5640 get frame by mirror format"
	depends on OV5640
	default n
```

## ugelis/drivers/camera/ov7725/Kconfig
```kconfig
# Kconfig - MPU6050 Six-Axis Motion Tracking device configuration options

#
# Copyright (c) 2016 Intel Corporation
#
# SPDX-License-Identifier: Apache-2.0
#

menuconfig OV7725
	bool "OmniVision OV7725 sensor support"
	depends on CAMERA_HAS_DRIVER
	default n
	help
	  This is a Video4Linux2 sensor-level driver for the Omnivision
	  OV7725 camera sensor with a MIPI CSI-2 interface.

config OV7725_0
	bool "Enable OV7725_0"
	depends on OV7725
    select DCMI_0
	default n

config OV7725_1
	bool "Enable OV7725_1"
	depends on OV7725
    select DCMI_1
	default n
	
config OV7725_MIRROR
	bool "OV7725 get frame by mirror format"
	depends on OV7725
	default n
```

## ugelis/drivers/camera/sccb/Kconfig
```kconfig
# Kconfig - MPU6050 Six-Axis Motion Tracking device configuration options

#
# Copyright (c) 2016 Intel Corporation
#
# SPDX-License-Identifier: Apache-2.0
#

menuconfig SCCB
	bool "Sccb Protocal for Camera"
	depends on CAMERA
	default n
	help
	  This is a Sccb Protocal for some cameras.
    
config SCCB_0
	bool "Enable SCCB_0"
	depends on SCCB
	default n

config SCCB_1
	bool "Enable SCCB_1"
	depends on SCCB
	default n
```

## ugelis/drivers/can/Kconfig
```kconfig
# Kconfig - CAN configuration options

#
# Copyright (c) 2018 Alexander Wachter
#
# SPDX-License-Identifier: Apache-2.0
#

#
# CAN options
#
menuconfig CAN
	bool
	prompt "CAN Support"
	default n
	help
	  Include support for can.

if CAN
	source "drivers/can/Kconfig.gm"
endif
```

## ugelis/drivers/can/Kconfig.gm
```kconfig
# Kconfig.stm32 - STM32 CAN configuration options

#
# Copyright (c) 2018 Alexander Wachter
#
# SPDX-License-Identifier: Apache-2.0
#

config CAN_GM
	bool "CAN Driver for Gree family of MCUs"
	default n
	help
	  Enable CAN driver for Gree line of MCUs 
```

## ugelis/drivers/crypto/Kconfig.gm
```kconfig
# KConfig.gm - GM crypto engine driver configuration

config CRYPTO_GM
    bool "GM crypto engine driver"
    depends on CRYPTO && SOC_FAMILY_GM
    help
        This option enables the crypto engine, which used to
        encrypt/decrypt data. It's available for GM6721 series.

config CRYPTO_GM_DEV_NAME
	string "Device name for GM crypto engine"
	default "CRYPTO_GM_DEV"
	depends on CRYPTO_GM
	help
	  Device name for GM crypto engine.
```

## ugelis/drivers/dac/Kconfig
```kconfig
# Kconfig - DAC configuration options

#
# Copyright (c) 2015 Intel Corporation
#
# SPDX-License-Identifier: Apache-2.0
#

#
# DAC options
#
menuconfig DAC
	bool
	prompt "DAC drivers"
	help
	  Enable DAC (Digital to Analog Converter) driver configuration

if DAC

config SYS_LOG_DAC_LEVEL
	int
	prompt "DAC drivers log level"
	depends on DAC
	default 0
	range 0 4
	help

	  Sets log level for DAC driver.

	  Levels are:

	  - 0 OFF, do not write

	  - 1 ERROR, only write SYS_LOG_ERR

	  - 2 WARNING, write SYS_LOG_WRN in addition to previous level

	  - 3 INFO, write SYS_LOG_INF in addition to previous levels

	  - 4 DEBUG, write SYS_LOG_DBG in addition to previous levels

config DAC_INIT_PRIORITY
	int
	default 80
	prompt "Init priority"
	help
	  DAC Device driver initialization priority.

config DAC_0
	bool "Enable DAC 0"

config DAC_0_NAME
	string "DAC 0 Driver's name"
	depends on DAC_0
	default "DAC_0"

config DAC_0_IRQ_PRI
	int
	depends on DAC_0
	prompt "DAC 0 interrupt priority"
	default 2

config DAC_1
	bool "Enable DAC 1"

config DAC_1_NAME
	string "DAC 1 Driver's name"
	depends on DAC_1
	default "DAC_1"

config DAC_1_IRQ_PRI
	int
	depends on DAC_1
	prompt "DAC 1 interrupt priority"
	default 2    
    
source "drivers/dac/Kconfig.gm"

endif # DAC
```

## ugelis/drivers/dac/Kconfig.gm
```kconfig
# Kconfig - DAC configuration options

#
# Copyright (c) 2015 Intel Corporation
#
# SPDX-License-Identifier: Apache-2.0
#

menuconfig DAC_GM
	bool
    prompt   "DAC Gree Driver"
	default y
	select DAC_0
	help
	  Enable the driver implementation of the Designware DAC IP.
```

## ugelis/drivers/display/Kconfig.gm
```kconfig
# Kconfig - GM6721X DISPLAY configuration
#
# Copyright (c) 2016 Open-RnD Sp. z o.o.
#
# SPDX-License-Identifier: Apache-2.0
#

menuconfig DISPLAY_GM6721X
	bool "DISPLAY Driver for GM6721X family of MCUs"
	depends on SOC_SERIES_GM6721X
	default n
	help
	Enable DISPLAY driver for GM6721X line of MCUs

config LCD1024x600
	bool "Enable 7' LCD 1024x600"
	depends on DISPLAY_GM6721X
	default n
    
config LCD800x480
	bool "Enable 7' LCD 800x480"
	depends on DISPLAY_GM6721X
	default n
```

## ugelis/drivers/dma/Kconfig
```kconfig
# Kconfig - DMA configuration options
#
#
# Copyright (c) 2016 Intel Corporation
#
# SPDX-License-Identifier: Apache-2.0
#

#
# DMA options
#
menuconfig DMA
	bool
	prompt "DMA Support"
	default n
	help
	  Include support for dma.

if DMA
	source "drivers/dma/Kconfig.gm"

	source "drivers/dma/Kconfig.cavs"

endif # DMA
```

## ugelis/drivers/dma/Kconfig.gm
```kconfig
# Kconfig - stm32 DMA configuration options
#
#
# Copyright (c) 2016 Intel Corporation
#
# SPDX-License-Identifier: Apache-2.0
#

menuconfig DMA_GM
	bool
	prompt "DMA Support"
	default n
	help
	  Include support for dma.
```

## ugelis/drivers/entropy/Kconfig.gm
```kconfig
# Kconfig.gm - GM entropy generator driver configuration

config ENTROPY_GM_RNG
	bool "GM random number generator driver"
	depends on ENTROPY_GENERATOR && SOC_FAMILY_GM
	select ENTROPY_HAS_DRIVER
	help
	  This option enables the RNG processor, which is an entropy number
	  generator, based on a continuous analog noise, that provides
	  a entropy 32-bit value to the host when read. It is available for
	  GM67xx series.
```

## ugelis/drivers/flash/Kconfig
```kconfig
# Kconfig - Flash driver configuration options

#
# Copyright (c) 2016 Intel Corporation
#
# SPDX-License-Identifier: Apache-2.0
#

#
# Flash driver
#
config FLASH_HAS_DRIVER_ENABLED
	bool
	help
	  This option is enabled when any flash driver is enabled.

config FLASH_HAS_PAGE_LAYOUT
	bool
	help
	  This option is enabled when the SoC flash driver supports
	  retrieving the layout of flash memory pages.

menuconfig FLASH
	bool
	prompt "FLASH support"
	help
	  Enable support for the flash hardware.
	  
menuconfig SFLASH
	bool
	prompt "SFLASH support"
	help
	  Enable support for the flash hardware.

config FLASH_PAGE_LAYOUT
	bool "API for retrieving the layout of pages"
	depends on FLASH && FLASH_HAS_PAGE_LAYOUT
	help
	  Enables API for retrieving the layout of flash memory pages.


config SOC_FLASH_MCUX
	bool "MCUX flash shim driver"
	depends on FLASH && HAS_MCUX
	select FLASH_HAS_PAGE_LAYOUT
	select FLASH_HAS_DRIVER_ENABLED
	help
	  Enables the MCUX flash shim driver.
	  WARNING: This driver will disable the system interrupts for
	  the duration of the flash erase/write operations. This will
	  have an impact on the overall system performance - whether
	  this is acceptable or not will depend on the use case.

source "drivers/flash/Kconfig.gm"

source "drivers/flash/Kconfig.w25qxxdv"
```

## ugelis/drivers/flash/Kconfig.gm
```kconfig
# Kconfig - Gree MMC configuration
#
# Copyright (c) 2018 Open-RnD Sp. z o.o.
#
# SPDX-License-Identifier: Apache-2.0
#

config SQI_GM
	bool "SQI Driver for Gree family of MCUs"
	default n
	help
	  Enable SQI driver for Gree line of MCUs
```
